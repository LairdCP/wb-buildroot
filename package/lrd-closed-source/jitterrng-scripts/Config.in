## package/lrd-closed-source/jitterrng-scripts/Config.in
```kconfig
config BR2_PACKAGE_JITTERRNG_SCRIPTS
	bool "FIPS Jitter RNG Data collection scripts"
```

## package/lrd-closed-source/laird_firmware/Config.in
```kconfig
config BR2_PACKAGE_LAIRD_FIRMWARE
	bool "Laird Firmware"
	help
	  Allow installation of Laird firmware or public Linux firmware
	  from the Laird firmware repository.

if BR2_PACKAGE_LAIRD_FIRMWARE

config BR2_PACKAGE_LAIRD_FIRMWARE_AR6003
	bool "Laird 45-series"
	help
	  Install Laird's AR6003 firmware and calibration data for the 45
	  series radios.

config BR2_PACKAGE_LAIRD_FIRMWARE_AR6003_MFG
	bool "Laird 45-series Mfg"
	help
	  Install Laird's AR6003 manufacturing firmware for the 45
	  series radios.

config BR2_PACKAGE_LAIRD_FIRMWARE_AR6004
	bool "Laird 50-series"
	help
	  Install Laird's AR6004 firmware and calibration data for the 50
	  series radios.

config BR2_PACKAGE_LAIRD_FIRMWARE_AR6004_MFG
	bool "Laird 50-series Mfg"
	help
	  Install Laird's AR6004 manufacturing firmware for the 50
	  series radios.

config BR2_PACKAGE_LAIRD_FIRMWARE_AR6004_PUBLIC
	bool "Upstream AR6004"
	help
	  Install public linux-firmware AR6004 firmware and calibration
	  data for Laird 50 series radios and Silex radios.

config BR2_PACKAGE_LAIRD_FIRMWARE_BCM4343
	bool "Laird LWB"
	help
	  Install Laird's firmware for the LWB Sterling radio.

config BR2_PACKAGE_LAIRD_FIRMWARE_BCM4343_MFG
	bool "Laird LWB MFG"
	help
	  Install Laird's manufacturing test firmware
	  for the LWB Sterling radio.

config BR2_PACKAGE_LAIRD_FIRMWARE_BCM43439
	bool "Laird LWB+"
	help
	  Install Laird's firmware for the LWB+ Sterling radio.

config BR2_PACKAGE_LAIRD_FIRMWARE_BCM43439_MFG
	bool "Laird LWB+ MFG"
	help
	  Install Laird's manufacturing test firmware
	  for the LWB+ Sterling radio.

config BR2_PACKAGE_LAIRD_FIRMWARE_BCM4339
	bool "Laird LWB5"
	help
	  Install Laird's firmware for the LWB5 Sterling radio.

config BR2_PACKAGE_LAIRD_FIRMWARE_BCM4339_MFG
	bool "Laird LWB5 MFG"
	help
	  Install Laird's manufacturing test firmware
	  for the LWB5 Sterling radio.

config BR2_PACKAGE_LAIRD_FIRMWARE_BCM4373_SDIO_DIV
	bool "Laird LWB5+ SDIO/UART with antenna diversity"
	help
	  Install Laird's firmware for the LWB5+ Sterling radio with
	  SDIO/UART interface and antenna diversity.

config BR2_PACKAGE_LAIRD_FIRMWARE_BCM4373_SDIO_SA
	bool "Laird LWB5+ SDIO/UART with single antenna"
	help
	  Install Laird's firmware for the LWB5+ Sterling radio with
	  SDIO/UART interface using a single antenna.

config BR2_PACKAGE_LAIRD_FIRMWARE_BCM4373_SDIO_SA_M2
	bool "Laird LWB5+ SDIO/UART with single antenna (M.2)"
	help
	  Install Laird's firmware for the LWB5+ Sterling radio with
	  SDIO/UART interface using a single antenna on the M.2 module.

config BR2_PACKAGE_LAIRD_FIRMWARE_BCM4373_USB_DIV
	bool "Laird LWB5+ USB with antenna diversity"
	help
	  Install Laird's firmware for the LWB5+ Sterling radio with
	  USB/USB interface and antenna diversity.

config BR2_PACKAGE_LAIRD_FIRMWARE_BCM4373_USB_SA
	bool "Laird LWB5+ USB with single antenna"
	help
	  Install Laird's firmware for the LWB5+ Sterling radio with
	  USB/USB interface using a single antenna.

config BR2_PACKAGE_LAIRD_FIRMWARE_BCM4373_USB_SA_M2
	bool "Laird LWB5+ USB with single antenna (M.2)"
	help
	  Install Laird's firmware for the LWB5+ Sterling radio with
	  USB/USB interface using a single antenna on the M.2 module.

config BR2_PACKAGE_LAIRD_FIRMWARE_BCM4373_MFG
	bool "Laird LWB5+ MFG"
	help
	  Install Laird's manufacturing test firmware
	  for the LWB5+ Sterling radio.

config BR2_PACKAGE_LAIRD_FIRMWARE_CYW55571_PCIE
	depends on BR2_PACKAGE_LAIRD_FIRMWARE
	bool "Laird LWB6 PCIE/UART"
	help
	  Install Laird's firmware for the LWB6 (1x1) Sterling radio with
	  PCIE/UART interface.

config BR2_PACKAGE_LAIRD_FIRMWARE_CYW55571_SDIO
	depends on BR2_PACKAGE_LAIRD_FIRMWARE
	bool "Laird LWB6 SDIO/UART"
	help
	  Install Laird's firmware for the LWB6 (1x1) Sterling radio with
	  SDIO/UART interface.

config BR2_PACKAGE_LAIRD_FIRMWARE_CYW55573_PCIE
	depends on BR2_PACKAGE_LAIRD_FIRMWARE
	bool "Laird LWB6+ PCIE/UART"
	help
	  Install Laird's firmware for the LWB6+ (2x2) Sterling radio with
	  PCIE/UART interface.

config BR2_PACKAGE_LAIRD_FIRMWARE_CYW55573_SDIO
	depends on BR2_PACKAGE_LAIRD_FIRMWARE
	bool "Laird LWB6+ SDIO/UART"
	help
	  Install Laird's firmware for the LWB6+ (2x2) Sterling radio with
	  SDIO/UART interface.

config BR2_PACKAGE_LAIRD_FIRMWARE_CYW5557X_MFG
	depends on BR2_PACKAGE_LAIRD_FIRMWARE
	bool "Laird LWB6x MFG"
	help
	  Install Laird's manufacturing test firmware
	  for the LWB6/LWB6+ Sterling radio.

config BR2_PACKAGE_LAIRD_FIRMWARE_MRVL_SD8997
	bool "Upstream full-MAC SD8997"
	help
	  Install public linux-firmware SD8997 firmware for the full-MAC
	  mwifiex driver.

config BR2_PACKAGE_LAIRD_FIRMWARE_LRDMWL_ST60_SDIO_UART
	bool "Laird Sterling 60 SDIO-UART"
	help
	  Install firmware for Laird's Sterling 60 SDIO WiFi-UART BT combo radio.

config BR2_PACKAGE_LAIRD_FIRMWARE_LRDMWL_ST60_SDIO_SDIO
	bool "Laird Sterling 60 SDIO-SDIO"
	help
	  Install firmware for Laird's Sterling 60 SDIO WiFi-SDIO BT combo radio.

config BR2_PACKAGE_LAIRD_FIRMWARE_LRDMWL_ST60_PCIE_UART
	bool "Laird Sterling 60 PCIE-UART"
	help
	  Install firmware for Laird's Sterling 60 PCIE WiFi-UART BT combo radio.

config BR2_PACKAGE_LAIRD_FIRMWARE_LRDMWL_ST60_PCIE_USB
	bool "Laird Sterling 60 PCIE-USB"
	help
	  Install firmware for Laird's Sterling 60 PCIE WiFi-USB BT combo radio.

config BR2_PACKAGE_LAIRD_FIRMWARE_LRDMWL_ST60_USB_UART
	bool "Laird Sterling 60 USB-UART"
	help
	  Install firmware for Laird's Sterling 60 USB WiFi-UART BT combo radio.

config BR2_PACKAGE_LAIRD_FIRMWARE_LRDMWL_ST60_USB_USB
	bool "Laird Sterling 60 USB-USB"
	help
	  Install firmware for Laird's Sterling 60 USB WiFi-USB BT combo radio.

config BR2_PACKAGE_LAIRD_FIRMWARE_LRDMWL_SU60_SDIO_UART
	bool "Laird Summit 60 SDIO-UART"
	help
	  Install firmware for Laird's Summit 60 SDIO WiFi-UART BT combo radio.

config BR2_PACKAGE_LAIRD_FIRMWARE_LRDMWL_SU60_SDIO_SDIO
	bool "Laird Summit 60 SDIO-SDIO"
	help
	  Install firmware for Laird's Summit 60 SDIO WiFi-SDIO BT combo radio.

config BR2_PACKAGE_LAIRD_FIRMWARE_LRDMWL_SU60_PCIE_UART
	bool "Laird Summit 60 PCIE-UART"
	help
	  Install firmware for Laird's Summit 60 PCIE WiFi-UART BT combo radio.

config BR2_PACKAGE_LAIRD_FIRMWARE_LRDMWL_SU60_PCIE_USB
	bool "Laird Summit 60 PCIE-USB"
	help
	  Install firmware for Laird's Summit 60 PCIE WiFi-USB BT combo radio.

config BR2_PACKAGE_LAIRD_FIRMWARE_LRDMWL_SU60_USB_UART
	bool "Laird Summit 60 USB-UART"
	help
	  Install firmware for Laird's Summit 60 USB WiFi-UART BT combo radio.

config BR2_PACKAGE_LAIRD_FIRMWARE_LRDMWL_SU60_USB_USB
	bool "Laird Summit 60 USB-USB"
	help
	  Install firmware for Laird's Summit 60 USB WiFi-USB BT combo radio.

config BR2_PACKAGE_LAIRD_FIRMWARE_LRDMWL_SOM60
	bool "Laird SOM60"
	help
	  Install firmware for the Laird SOM60's SDIO WiFi-UART BT combo radio.

config BR2_PACKAGE_LAIRD_FIRMWARE_LRDMWL_SOM8MP
	bool "Laird SOM8M+"
	help
	  Install firmware for the Laird SOM8M+ radio.

config BR2_PACKAGE_LAIRD_FIRMWARE_LRDMWL_SD8997_MFG
	bool "Laird 60-series MFG"
	help
	  Install Laird's SD8997 manufacturing test firmware for the
	  thin-MAC lrdwifi driver.

config BR2_PACKAGE_LAIRD_FIRMWARE_WL18XX
	bool "TI WL18XX"
	help
	  Install public linux-firmware for the TI WiLink8 wl1835 and
	  wl1837 radios. Installs the proper configuration for use on a
	  WB50-RDVK and sets up for default use of the wl1837. Should be
	  used in conjunction of our setup scripts.

config BR2_PACKAGE_LAIRD_FIRMWARE_BT
	bool "Bluetopia"
	help
	  Install bluetopia patchram for the 50.

config BR2_PACKAGE_LAIRD_FIRMWARE_AR9271
	bool "AR9271"
	help
		Install Atheros AR9271 firmware.  Used by TP-Link TL-WN722N

endif
```

## package/lrd-closed-source/libbluetopia/Config.in
```kconfig
config BR2_PACKAGE_LIBBLUETOPIA
	bool "libbluetopia"
	help
	  Bluetopia is the Bluetooth Protocol Stack by StoneStreet One.
	  It provides a software architecture that encapsulates the 
	  upper functionality of the Bluetooth Protocol Stack. The 
	  package libbluetopia includes the Bluetopia library files.  
```

## package/lrd-closed-source/llagent/Config.in
```kconfig
config BR2_PACKAGE_LLAGENT
    bool "llagent"
    select BR2_PACKAGE_LIBNL
    help
        LairdLink Agent
```

## package/lrd-closed-source/lru_ath6kl/Config.in
```kconfig
config BR2_PACKAGE_LRU_ATH6KL
	bool "LRU Ath6kl"
	select BR2_PACKAGE_LIBNL
	select BR2_PACKAGE_LIBEDIT
	help
	  LRU Tools

if BR2_PACKAGE_LRU_ATH6KL

choice
	prompt "AR600x Series Radio Utilities"
	default BR2_PACKAGE_LRU_ATH6KL_WB45N_SUPPORT

config BR2_PACKAGE_LRU_ATH6KL_WB45N_SUPPORT
	bool "WB45N support"
	help
		Builds Regulatory tool to support WB45n(AR6003).

config BR2_PACKAGE_LRU_ATH6KL_WB50N_SUPPORT
	bool "WB50N support"
	help
		Builds Regulatory tool to support WB50n(AR6004).
endchoice

endif
```

## package/lrd-closed-source/lru_cypress/Config.in
```kconfig
config BR2_PACKAGE_LRU_CYPRESS
	bool "Laird LWB5+ Regulatory Utilities"
	select BR2_PACKAGE_LIBNL
	select BR2_PACKAGE_LIBEDIT
	depends on BR2_PACKAGE_BLUEZ5_UTILS || BR2_PACKAGE_BLUEZ_UTILS
	help
		Regulatory utilities for Cypress and Broadcom chipsets, currently supported on LWB5+ only
```

## package/lrd-closed-source/mfg60n/Config.in
```kconfig
config BR2_PACKAGE_MFG60N
	bool "60 Series Radio Utilities"
	help
		Laird Manufacturing and Regulatory Tools

if BR2_PACKAGE_MFG60N
choice
	prompt "60 Series Radio Utilities"
	default BR2_PACKAGE_MFG60N_VENDOR

config BR2_PACKAGE_MFG60N_VENDOR
	depends on BR2_PACKAGE_BLUEZ5_UTILS || BR2_PACKAGE_BLUEZ_UTILS
	bool "Vendor Package"
	select BR2_PACKAGE_MFG60N_BTLRU
	select BR2_PACKAGE_MFG60N_LMU
	select BR2_PACKAGE_MFG60N_LRU
	select BR2_PACKAGE_MFG60N_LIBEDIT
	help
		Laird Manufacturing and Regulatory Tools for vendors

config BR2_PACKAGE_MFG60N_CUSTOM
	bool "Custom Package"
	help
		Select Individual Laird Manufacturing and Radio Tools

config BR2_PACKAGE_MFG60N_LRT
	bool "Radio Manufacturing Tool"
	select BR2_PACKAGE_LIBNL
	help
		Laird Radio Manufacturing Tool
endchoice

if !BR2_PACKAGE_MFG60N_LRT
config BR2_PACKAGE_MFG60N_LIBEDIT
	bool "Use Command Line Recall"
	select BR2_PACKAGE_LIBEDIT
	default y
	help
		Build vendor tools with support for libedit command line history

config BR2_PACKAGE_MFG60N_BTLRU
	depends on BR2_PACKAGE_BLUEZ5_UTILS || BR2_PACKAGE_BLUEZ_UTILS
	bool "Bluetooth Regulatory Tool"
	default y
	help
		Include Bluetooth Regulatory tool

config BR2_PACKAGE_MFG60N_LMU
	bool "Manufacturing Tool"
	select BR2_PACKAGE_LIBNL
	default y
	help
		Include Manufacturing tool

config BR2_PACKAGE_MFG60N_LRU
	bool "Wi-Fi Regulatory Tool"
	select BR2_PACKAGE_LIBNL
	select BR2_PACKAGE_LAIRD_FIRMWARE
	select BR2_PACKAGE_LAIRD_FIRMWARE_LRDMWL_SD8997_MFG
	default y
	help
		Include Wi-Fi Regulatory tool
endif
endif
```

## package/lrd-closed-source/ncm/Config.in
```kconfig
config BR2_PACKAGE_NCM
	bool "NCM"
	select BR2_PACKAGE_MSD_BINARIES
	help
	  NCM
```

## package/lrd-closed-source/openssl-fips/Config.in
```kconfig
config BR2_PACKAGE_OPENSSL_FIPS
	bool "openssl-fips"
	select BR2_PACKAGE_ZLIB
	help
	  Build FIPS support for openssl.
	  http://www.openssl.org/

if BR2_PACKAGE_OPENSSL_FIPS

config BR2_PACKAGE_LAIRD_OPENSSL_FIPS
	bool "Laird openssl-fips version"
	help
	  Builds the Laird openssl-fips/openssl.

config BR2_PACKAGE_LAIRD_OPENSSL_FIPS_DEBUG
	bool "openssl-fips debug version for functional testing"
	help
	  Builds the Laird openssl-fips/openssl debug version.

endif
```

## package/lrd-closed-source/openssl-testing/Config.in
```kconfig
config BR2_PACKAGE_OPENSSL_TESTING
	bool "FIPS OpenSSL Testing"
	select BR2_PACKAGE_OPENSSL
```

## package/lrd-closed-source/parser-acvp/Config.in
```kconfig
config BR2_PACKAGE_PARSER_ACVP
	bool "FIPS ACVP Parser"
	select BR2_PACKAGE_LIBGCRYPT
	select BR2_PACKAGE_LIBGPG_ERROR
	select BR2_PACKAGE_OPENSSL
	select BR2_PACKAGE_KEYUTILS
```

## package/lrd-closed-source/parser-cavs/Config.in
```kconfig
config BR2_PACKAGE_PARSER_CAVS
	bool "FIPS CAVS Parser"
	select BR2_PACKAGE_LIBGCRYPT
	select BR2_PACKAGE_LIBGPG_ERROR
	select BR2_PACKAGE_OPENSSL
	select BR2_PACKAGE_KEYUTILS
```

## package/lrd-closed-source/sdc2u/Config.in
```kconfig
config BR2_PACKAGE_SDC2U
    select BR2_PACKAGE_OPENSSL
	bool "SDC2U DRIVER FOR CCMP_FIPS"
	help
	  Builds sdcu app for ccmp_fips on the wb45n.
	  Fips compatible modules, driver and firmware is required.
```

## package/lrd-closed-source/sdccli/Config.in
```kconfig
config BR2_PACKAGE_SDCCLI
	bool "SDC CLI"
	select BR2_PACKAGE_LIBEDIT
	depends on BR2_PACKAGE_SDCSDK_NM || BR2_PACKAGE_SDCSDK
	help
	  SDC CLI

if BR2_PACKAGE_SDCCLI

config BR2_PACKAGE_SDCCLI_SDC_CLI
	bool "Install sdc_cli binary"
	default y
	help
	  Install sdc_cli command line utility

config BR2_PACKAGE_SDCCLI_SMU_CLI
	bool "Install smu_cli binary"
	depends on !BR2_PACKAGE_SDCSDK_NM
	help
	  Install smu_cli command line utility

endif
```

## package/lrd-closed-source/sdcsdk/Config.in
```kconfig
config BR2_PACKAGE_SDCSDK
	bool "SDC SDK"
	select BR2_PACKAGE_LIBNL
	depends on !BR2_LRD_PLATFORM_SOM60
	help
	  WB SDK
```

## package/lrd-closed-source/sdcsdk_nm/Config.in
```kconfig
config BR2_PACKAGE_SDCSDK_NM
	bool "SDC SDK"
	select BR2_PACKAGE_LIBNL
	select BR2_PACKAGE_LRD_NETWORK_MANAGER
	depends on BR2_LRD_PLATFORM_SOM60
	help
	  Summit SDK
```

## package/lrd-closed-source/sdcsupp/Config.in
```kconfig
config BR2_PACKAGE_SDCSUPP
	bool "SDC Supplicant"
	select BR2_PACKAGE_LIBNL
	help
	  SDC Supplicant

if BR2_PACKAGE_SDCSUPP

config BR2_PACKAGE_SDCSUPP_WPA_CLI
	bool "Install wpa_cli binary"
	help
	  Install wpa_cli command line utility

config BR2_PACKAGE_SDCSUPP_WPA_PASSPHRASE
	bool "Install wpa_passphrase binary"
	help
	  Install wpa_passphrase command line utility.

config BR2_PACKAGE_SDCSUPP_LEGACY
	bool "SDC Supplicant Legacy"

endif
```

## package/lrd-closed-source/smartbasic/Config.in
```kconfig
config BR2_PACKAGE_SMARTBASIC
	bool "smartbasic"
	help
	  smartBASIC is an implementation of a structured BASIC programming language 
	  optimised for use on low-cost embedded systems.
```

## package/lrd-closed-source/web_lcm/Config.in
```kconfig
config BR2_PACKAGE_WEB_LCM
	bool "web_lcm"
	select BR2_PACKAGE_ZLIB
	help
	  Laird webapp to configure wifi settings
	    http://lairdtech.com
```

## package/lrd-closed-source/web_lcm_gatwick/Config.in
```kconfig
config BR2_PACKAGE_WEB_LCM_GATWICK
	bool "web_lcm_gatwick"
	help
	  Laird webapp to configure LoRa gateway
	    http://lairdtech.com
```

## package/lrd-closed-source/wireless-firmware/Config.in
```kconfig
config BR2_PACKAGE_WIRELESS_FIRMWARE
	bool "wireless-firmware"
	select BR2_PACKAGE_WIRELESS_REGDB
	help
	  Firmwares for wireless drivers.
```

## package/lrd-closed-source/wl_fmac/Config.in
```kconfig
config BR2_PACKAGE_WL_FMAC
	bool "wl fmac"
	select BR2_PACKAGE_LIBNL
	help
	  wl for fmac
```
