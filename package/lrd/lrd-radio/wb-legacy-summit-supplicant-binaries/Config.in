## package/lrd/lrd-radio/wb-legacy-summit-supplicant-binaries/Config.in
```kconfig
config BR2_PACKAGE_WB_LEGACY_SUMMIT_SUPPLICANT_BINARIES
	bool "WB Legacy Summit Supplicant ARM EABI Binaries Installer"
	select BR2_PACKAGE_LIBNL
	select BR2_PACKAGE_LIBEDIT
	select BR2_PACKAGE_OPENSSL
	select BR2_PACKAGE_SDCSUPP if BR2_LRD_DEVEL_BUILD="y"
	select BR2_PACKAGE_SDCSUPP_LEGACY if BR2_LRD_DEVEL_BUILD="y"
	select BR2_PACKAGE_SDCSDK if BR2_LRD_DEVEL_BUILD="y"
	select BR2_PACKAGE_SDCCLI if BR2_LRD_DEVEL_BUILD="y"
	help
	  Extracts sdcsupp, wpa_cli binaries from summit supplicant release and install them on the target.
```

## package/lrd/lrd-radio/wb45n-firmware-binaries/Config.in
```kconfig
config BR2_PACKAGE_WB45N_FIRMWARE_BINARIES
	bool "WB45N Firmware Installer"
	select BR2_PACKAGE_LAIRD_FIRMWARE if BR2_LRD_DEVEL_BUILD="y"
	select BR2_PACKAGE_LAIRD_FIRMWARE_AR6004 if BR2_LRD_DEVEL_BUILD="y"
	select BR2_PACKAGE_WIRELESS_REGDB if BR2_LRD_DEVEL_BUILD="y"
	depends on BR2_LRD_WB45N_RADIO
	help
	  Extracts the Laird wb45n wireless firmware binaries from the
	  binary firmware release and install them on the target.
```

## package/lrd/lrd-som60-radio/Config.in
```kconfig
config BR2_PACKAGE_LRD_RADIO_STACK_VERSION_VALUE
	string "SOM60 radio stack version"
	default "8.0.0.8"
	depends on BR2_LRD_SOM60_RADIO || BR2_LRD_SOM60_FIPS_RADIO
	help
	Version number for radio packages.

source "package/lrd/lrd-som60-radio/adaptive_ww-binaries/Config.in"
source "package/lrd/lrd-som60-radio/som60-firmware-binaries/Config.in"
source "package/lrd/lrd-som60-radio/summit-supplicant-binaries/Config.in"
source "package/lrd/lrd-som60-radio/mfg60n-arm-eabihf-binaries/Config.in"
```

## package/lrd/lrd-som60-radio/adaptive_ww-binaries/Config.in
```kconfig
config BR2_PACKAGE_ADAPTIVE_WW_BINARIES
	bool "Summit Adaptive World Mode Binaries Installer"
	select BR2_PACKAGE_ADAPTIVE_WW if BR2_LRD_DEVEL_BUILD="y"
	depends on BR2_LRD_SOM60_RADIO || BR2_LRD_SOM60_FIPS_RADIO

	help
	  Extracts adaptive_ww from adaptive_ww-arm release and installs them on the target.

if BR2_PACKAGE_ADAPTIVE_WW_BINARIES
config BR2_PACKAGE_ADAPTIVE_WW_BINARIES_REGPWRDB
	bool "Adaptive World Mode Regulatory Powers Database"
	default y
	help
		A default Adaptive World Mode Regulatory Powers Database
endif
```

## package/lrd/lrd-som60-radio/summit-supplicant-binaries/Config.in
```kconfig
config BR2_PACKAGE_SUMMIT_SUPPLICANT_BINARIES
	bool "SOM60 Summit Supplicant ARM EABIHF Binaries Installer"
	select BR2_PACKAGE_SDCSUPP if BR2_LRD_DEVEL_BUILD="y"
	select BR2_PACKAGE_SDCSUPP_WPA_CLI if BR2_LRD_DEVEL_BUILD="y"
	depends on (BR2_LRD_SOM60_RADIO && !BR2_PACKAGE_LAIRD_OPENSSL_FIPS && !BR2_PACKAGE_LAIRD_OPENSSL_FIPS_BINARIES) || (BR2_LRD_SOM60_FIPS_RADIO && (BR2_PACKAGE_LAIRD_OPENSSL_FIPS || BR2_PACKAGE_LAIRD_OPENSSL_FIPS_BINARIES))
	help
	  Extracts sdcsupp, wpa_cli binaries from summit supplicant release and install them on the target.
```

## package/lrd/lrd-usbgadget/Config.in
```kconfig
menuconfig BR2_PACKAGE_LRD_USBGADGET
	bool "lrd-usb-gadget"
	help
	  Laird USB Ethernet Gadget

if BR2_PACKAGE_LRD_USBGADGET
choice BR2_PACKAGE_LRD_USBGADGET_TYPE
	prompt "USB Gadget Ethernet Type"
	default BR2_PACKAGE_LRD_USBGADGET_TYPE_RNDIS
	help
	  Laird USB Ethernet Gadget Type

config BR2_PACKAGE_LRD_USBGADGET_TYPE_NONE
	bool "None"
	help
	  Laird RNDIS USB Ethernet Gadget None

config BR2_PACKAGE_LRD_USBGADGET_TYPE_RNDIS
	bool "RNDIS"
	help
	  Laird RNDIS USB Ethernet Gadget RNDIS

config BR2_PACKAGE_LRD_USBGADGET_TYPE_NCM
	bool "NCM"
	help
	  Laird RNDIS USB Ethernet Gadget NCM

endchoice

config BR2_PACKAGE_LRD_USBGADGET_TYPE_STRING
	string
	default "rndis" if BR2_PACKAGE_LRD_USBGADGET_TYPE_RNDIS
	default "ncm"   if BR2_PACKAGE_LRD_USBGADGET_TYPE_NCM

config BR2_PACKAGE_LRD_USBGADGET_SERIAL_PORTS
	int "USB Gadget Serial ports"
	default 0

endif
```

## package/lrd/lrd-userspace-examples/Config.in
```kconfig
config BR2_PACKAGE_LRD_USERSPACE_EXAMPLES
	bool "Laird Examples"
	select BR2_PACKAGE_LRD_NETWORK_MANAGER
	help
	  Laird userspace examples for som products.

if BR2_PACKAGE_LRD_USERSPACE_EXAMPLES

config BR2_PACKAGE_LRD_USERSPACE_NETWORKMANAGER_EXAMPLES
	bool "Build networkmanager examples"
	default n

config BR2_PACKAGE_LRD_USERSPACE_NETLINK_EXAMPLES
	bool "Build netlink examples"
	default n

config BR2_PACKAGE_LRD_USERSPACE_CMUX
	bool "Build cmux"
	default n

endif
```

## package/lrd/lrd-wb50legacy-radio/Config.in
```kconfig
config BR2_PACKAGE_LRD_RADIO_STACK_VERSION_VALUE
	string "WB50N legacy radio stack version"
	default "0.0.0.0"
	depends on BR2_LRD_WB50N_LEGACY_RADIO
	help
	Version number for radio packages.
source "package/lrd/lrd-wb50legacy-radio/msd-binaries/Config.in"
```

## package/lrd/lrd-wb50n-radio/Config.in
```kconfig
config BR2_PACKAGE_LRD_RADIO_STACK_VERSION_VALUE
	string "WB radio stack version"
	depends on BR2_LRD_WB50N_SYSD_RADIO || BR2_LRD_WB50N_SYSD_FIPS_RADIO || BR2_LRD_WB50N_LEGACY_RADIO || BR2_LRD_WB45N_RADIO
	help
	  Version number for radio packages.

source "package/lrd/lrd-wb50n-radio/wb50n-firmware-binaries/Config.in"
source "package/lrd/lrd-wb50n-radio/wb-legacy-summit-supplicant-binaries/Config.in"
source "package/lrd/lrd-wb50n-radio/wb50n-sysd-summit-supplicant-binaries/Config.in"
source "package/lrd/lrd-wb50n-radio/reg50n-arm-eabihf-binaries/Config.in"
```

## package/lrd/lrd-wb50n-radio/wb-legacy-summit-supplicant-binaries/Config.in
```kconfig
config BR2_PACKAGE_WB_LEGACY_SUMMIT_SUPPLICANT_BINARIES
	bool "WB Legacy Summit Supplicant ARM EABI Binaries Installer"
	select BR2_PACKAGE_LIBNL
	select BR2_PACKAGE_LIBEDIT
	select BR2_PACKAGE_SDCSUPP if BR2_LRD_DEVEL_BUILD="y"
	select BR2_PACKAGE_SDCSUPP_LEGACY if BR2_LRD_DEVEL_BUILD="y"
	select BR2_PACKAGE_SDCSDK if BR2_LRD_DEVEL_BUILD="y"
	select BR2_PACKAGE_SDCCLI if BR2_LRD_DEVEL_BUILD="y"
	depends on BR2_LRD_WB50N_LEGACY_RADIO || BR2_LRD_WB45N_RADIO
	help
	  Extracts sdcsupp, wpa_cli binaries from summit supplicant release and install them on the target.
```

## package/lrd/lrd-wb50n-radio/wb50n-firmware-binaries/Config.in
```kconfig
config BR2_PACKAGE_WB50N_FIRMWARE_BINARIES
	bool "WB50N Firmware Installer"
	select BR2_PACKAGE_LAIRD_FIRMWARE if BR2_LRD_DEVEL_BUILD="y"
	select BR2_PACKAGE_LAIRD_FIRMWARE_AR6004 if BR2_LRD_DEVEL_BUILD="y"
	select BR2_PACKAGE_WIRELESS_REGDB if BR2_LRD_DEVEL_BUILD="y"
	depends on BR2_LRD_WB50N_SYSD_RADIO || BR2_LRD_WB50N_SYSD_FIPS_RADIO || BR2_LRD_WB50N_LEGACY_RADIO
	help
	  Extracts the Laird wb50n wireless firmware binaries from the
	  binary firmware release and install them on the target.
```

## package/lrd/lrd-wb50n-radio/wb50n-sysd-summit-supplicant-binaries/Config.in
```kconfig
config BR2_PACKAGE_WB50N_SYSD_SUMMIT_SUPPLICANT_BINARIES
	bool "WB50n SYSD Summit Supplicant ARM EABIHF Binaries Installer"
	select BR2_PACKAGE_LIBNL
	select BR2_PACKAGE_DBUS
	select BR2_PACKAGE_SDCSUPP if BR2_LRD_DEVEL_BUILD="y"
	depends on BR2_LRD_WB50N_SYSD_RADIO || BR2_LRD_WB50N_SYSD_FIPS_RADIO
	help
	  Extracts sdcsupp, wpa_cli binaries from summit supplicant release and install them on the target.
```

## package/lrd/lrd-wb50sysd-radio/Config.in
```kconfig
config BR2_PACKAGE_LRD_RADIO_STACK_VERSION_VALUE
	string "WB50N sysd radio stack version"
	depends on BR2_LRD_WB50N_SYSD_RADIO || BR2_LRD_WB50N_SYSD_FIPS_RADIO
	help
	Version number for radio packages.
source "package/lrd/lrd-wb50sysd-radio/wb50n-firmware-binaries/Config.in"
source "package/lrd/lrd-wb50sysd-radio/wb50sysd-summit-supplicant-binaries/Config.in"
```

## package/lrd/lrd-wb50sysd-radio/wb50sysd-summit-supplicant-binaries/Config.in
```kconfig
config BR2_PACKAGE_WB50SYSD_SUMMIT_SUPPLICANT_BINARIES
	bool "WB50SYSD Summit Supplicant ARM EABIHF Binaries Installer"
	select BR2_PACKAGE_SDCSUPP if BR2_LRD_DEVEL_BUILD="y"
	depends on BR2_LRD_WB50N_SYSD_RADIO || BR2_LRD_WB50N_SYSD_FIPS_RADIO
	help
	  Extracts sdcsupp, wpa_cli binaries from summit supplicant release and install them on the target.
```

## package/lrd/msd-binaries/Config.in
```kconfig
config BR2_PACKAGE_MSD_BINARIES
	bool "MSD Installer"
	select BR2_PACKAGE_LIBNL
	help
      Extracts the Laird closed source binaries from an msd release and install them on the target.
      (sdcsupp, sdcsdk, sdc_cli, etc)

if BR2_PACKAGE_MSD_BINARIES

config BR2_MSD_BINARIES_COMPANY_PROJECT
	string "Laird Binaries company/project string"
	help
	  Specify the middle string of a msd name tag. I.e. company/project.
	  E.g. laird

config BR2_MSD_BINARIES_WEBLCM
	bool "Laird webLCM"
    default y
	help
	  Install the webLCM from the MSD package.

config BR2_MSD_BINARIES_EVENTMON
	bool "Laird event monitor"
    default y
	help
	  Install the eventmon from the MSD package.

config BR2_MSD_BINARIES_SDCCLI
	bool "Laird SDC CLI"
    default y
	help
	  Install the SDC CLI from the MSD package.

config BR2_MSD_BINARIES_SDCSUPP
	bool "Laird SDC Supplicant"
    default y
	help
	  Install the SDC Supplicant from the MSD package.

config BR2_MSD_BINARIES_LLAGENT
	bool "Laird Link agent"
    default y
	help
	  Install the Laird Link agent from the MSD package.

config BR2_MSD_BINARIES_LAIRD_FIRMWARE_AR6003
	bool "Laird 45-series"
	default n
	help
	  Install Laird's AR6003 firmware and calibration data for the 45
	  series radios.

config BR2_MSD_BINARIES_LAIRD_FIRMWARE_AR6004
	bool "Laird 50-series"
	default n
	help
	  Install Laird's AR6004 firmware and calibration data for the 50
	  series radios.

config BR2_MSD_BINARIES_LAIRD_FIRMWARE_BT
	bool "Bluetopia"
	default n
	help
	  Install bluetopia patchram for Laird's 50 series radios.
endif
```

## package/lrd/msd40n-binaries/Config.in
```kconfig
config BR2_PACKAGE_MSD40N_BINARIES
	bool "MSD40N Installer"
	help
      Extracts the Laird closed source binaries from an msd40 release and install them on the target.
      (sdcsupp, sdcsdk, sdc_cli, etc)

if BR2_PACKAGE_MSD40N_BINARIES

config BR2_MSD40N_BINARIES_COMPANY_PROJECT
	string "Laird Binaries company/project string"
	help
	  Specify the middle string of a msd40n name tag. I.e. company/project.
	  E.g. laird

config BR2_MSD40N_BINARIES_VERSION
	string "Laird Binaries version"
	help
	  Specify the version of sdcbins to use.
	  E.g. alpha.0.2

endif
```

## package/lrd/msd45n-binaries/Config.in
```kconfig
config BR2_PACKAGE_MSD45N_BINARIES
	bool "MSD45N Installer"
	help
      Extracts the Laird closed source binaries from an msd45 release and install them on the target.
      (sdcsupp, sdcsdk, sdc_cli, etc)

if BR2_PACKAGE_MSD45N_BINARIES

config BR2_MSD45N_BINARIES_COMPANY_PROJECT
	string "Laird Binaries company/project string"
	help
	  Specify the middle string of a msd45n name tag. I.e. company/project.
	  E.g. laird or laird_fips

config BR2_MSD45N_BINARIES_VERSION
	string "Laird Binaries version"
	help
	  Specify the version of sdcbins to use.
	  E.g. alpha.0.2

endif
```

## package/lrd/openssl-fips/Config.in
```kconfig
config BR2_PACKAGE_OPENSSL_FIPS
	bool "openssl-fips"
	select BR2_PACKAGE_ZLIB
	help
	  Build FIPS support for openssl.
	  http://www.openssl.org/
```

## package/lrd/patchram/Config.in
```kconfig
config BR2_PACKAGE_PATCHRAM
	bool "BRCM PATCHRAM"
	help
	  Broadcom patchram utility.
```

## package/lrd/som60-firmware-binaries/Config.in
```kconfig
config BR2_PACKAGE_SOM60_FIRMWARE_BINARIES
	bool "som60 Firmware Installer"
	select BR2_PACKAGE_LAIRD_FIRMWARE if BR2_LRD_DEVEL_BUILD="y"
	select BR2_PACKAGE_LRD_WIRELESS_REGDB if BR2_LRD_DEVEL_BUILD="y"
	help
      Extracts the Laird som60 wireless firmware binaries from an firmware release and install them on the target.

if BR2_PACKAGE_SOM60_FIRMWARE_BINARIES

config BR2_PACKAGE_SOM60_FIRMWARE_BINARIES_VERSION_VALUE
	string "som60 firmware binaries version"

endif
```

## package/lrd/summit-firewall/Config.in
```kconfig
menuconfig BR2_PACKAGE_SUMMIT_FIREWALL
	bool "Summit Basic Wi-Fi NAT/Firewall"
	help
	  Summit Basic Wi-Fi NAT/Firewall

if BR2_PACKAGE_SUMMIT_FIREWALL

config BR2_PACKAGE_SUMMIT_FIREWALL_INTERFACE
	string "internal interface name"
	default "usb0"

config BR2_PACKAGE_SUMMIT_FIREWALL_INTERFACE_IPV4
	string "internal interface ipv4"
	default "198.18.101.1/24"
endif
```

## package/lrd/summit-supplicant-binaries/Config.in
```kconfig
config BR2_PACKAGE_SUMMIT_SUPPLICANT_BINARIES
	bool "SOM60 Summit Supplicant ARM EABIHF Binaries Installer"
	select BR2_PACKAGE_SDCSUPP if BR2_LRD_DEVEL_BUILD="y"
	select BR2_PACKAGE_SDCSUPP_WPA_CLI if BR2_LRD_DEVEL_BUILD="y"

	help
	  Extracts sdcsupp, wpa_cli binaries from summit_supplicant-arm release and install them on the target.
```

## package/lrd/wb50n-firmware-binaries/Config.in
```kconfig
config BR2_PACKAGE_WB50N_FIRMWARE_BINARIES
	bool "wb50n Firmware Installer"
	select BR2_PACKAGE_LAIRD_FIRMWARE if BR2_LRD_DEVEL_BUILD="y"
	help
      Extracts the Laird wb50n wireless firmware binaries from an firmware release and install them on the target.

if BR2_PACKAGE_WB50N_FIRMWARE_BINARIES

config BR2_PACKAGE_WB50N_FIRMWARE_BINARIES_VERSION_VALUE
	string "wb50n firmware binaries version"

config BR2_FIRMWARE_BINARIES_ATH6K_6003
	bool "Laird ath6k AR6003 radio firmware"
    default n
	select BR2_PACKAGE_LAIRD_FIRMWARE_AR6003 if BR2_LRD_DEVEL_BUILD="y"

config BR2_FIRMWARE_BINARIES_ATH6K_6004
	bool "Laird ath6k AR6004 radio firmware"
    default n
	select BR2_PACKAGE_LAIRD_FIRMWARE_AR6004 if BR2_LRD_DEVEL_BUILD="y"
	select BR2_PACKAGE_LRD_WIRELESS_REGDB if BR2_LRD_DEVEL_BUILD="y"

endif
```

## package/lrd/wb50sysd-summit-supplicant-binaries/Config.in
```kconfig
config BR2_PACKAGE_WB50SYSD_SUMMIT_SUPPLICANT_BINARIES
	bool "WB50SYSD Summit Supplicant ARM EABIHF Binaries Installer"
	select BR2_PACKAGE_SDCSUPP if BR2_LRD_DEVEL_BUILD="y"

	help
	  Extracts sdcsupp, wpa_cli binaries from summit_supplicant-arm release and install them on the target.
```

## package/lrd/wb_smartBASIC_apps/Config.in
```kconfig
config BR2_PACKAGE_WB_SMARTBASIC_APPS
	bool "wb_smartBASIC_apps"
	help
	  Laird smartBASIC applications
```
