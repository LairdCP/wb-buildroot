## package/lrd/weblcm-python/Config.in
```kconfig
config BR2_PACKAGE_WEBLCM_PYTHON
	bool "Laird Web Configuration Utility"
	help
	  Laird Web Configuration Utility
	select BR2_PACKAGE_PYTHON3
	select BR2_PACKAGE_GOBJECT_INTROSPECTION
	select BR2_PACKAGE_PYTHON_GOBJECT
	select BR2_PACKAGE_LRD_SWUPDATE_CLIENT
	select BR2_PACKAGE_PYTHON_SYSTEMD
	select BR2_PACKAGE_PYTHON3_SSL
	select BR2_PACKAGE_PYTHON_CHERRYPY
	select BR2_PACKAGE_ZIP
	select BR2_PACKAGE_UNZIP
	select BR2_PACKAGE_LIBOPENSSL_BIN
	select BR2_PACKAGE_SWUPDATE

if BR2_PACKAGE_WEBLCM_PYTHON

config BR2_PACKAGE_WEBLCM_PYTHON_DEFAULT_USERNAME
	string "default root user name"
	default "root"

config BR2_PACKAGE_WEBLCM_PYTHON_DEFAULT_PASSWORD
	string "default root user password"
	default "summit"

config BR2_PACKAGE_WEBLCM_PYTHON_SWUPDATE_KEY_LOCATION
	string "swupdate key location"
	default "/data/secret/swupdate/dev.crt"
	help
	  Location to key used to verify signed swupdate images.

config BR2_PACKAGE_WEBLCM_PYTHON_MANAGED_SOFTWARE_DEVICES
	string "List of supported software devices"
	default ""
	help
		Space separated software devices like bonds, bridges etc.
		Bridge devices should be named as "br0", "br1" etc.
		Bond devices should be named as "bn0", "bn1" etc.

config BR2_PACKAGE_WEBLCM_PYTHON_UNMANAGED_HARDWARE_DEVICES
	string "list of unmanaged hardware devices"
	default ""
	help
		Space separated hardware devices like eth0, wlan0 etc which are managed by networkManager,
		but don't want to be managed by weblcm-python.

config BR2_PACKAGE_WEBLCM_PYTHON_AWM
	bool "AWM configuration support for weblcm"
	depends on BR2_LRD_SOM60_RADIO
	select BR2_PACKAGE_PYTHON_LIBCONF
	default y
	help
		Add AWM (Adaptive Worldwide Mode) configuration support to weblcm.

config BR2_PACKAGE_WEBLCM_PYTHON_MODEM
	bool "Modem / positioning support for weblcm"
	help
		Add modem, positioning, positioning switch support to weblcm.

config BR2_PACKAGE_WEBLCM_PYTHON_BLUETOOTH
	bool "Bluetooth support for weblcm"
	depends on BR2_PACKAGE_BLUEZ5_UTILS
	default y
	help
		Add basic Bluetooth REST API support to weblcm (scanning/pairing/connecting), and BLE REST API (GATT central role).

config BR2_PACKAGE_WEBLCM_PYTHON_VSP
	bool "BLE VSP support for weblcm"
	depends on BR2_PACKAGE_WEBLCM_PYTHON_BLUETOOTH
	help
		Add BLE VSP support (rx/tx transfers over chosen GATT characteristics to TCP server) to weblcm.

config BR2_PACKAGE_WEBLCM_PYTHON_HID
	bool "HID BT barcode scanner support for weblcm"
	depends on BR2_PACKAGE_WEBLCM_PYTHON_BLUETOOTH
	select BR2_PACKAGE_PYTHON_PYUDEV
	help
		Add Bluetooth HID barcode scanner support to weblcm.

config BR2_PACKAGE_WEBLCM_PYTHON_WEBSOCKETS
	bool "Websockets support for BLE on weblcm"
	depends on BR2_PACKAGE_WEBLCM_PYTHON_BLUETOOTH
	select BR2_PACKAGE_PYTHON_WS4PY
	help
		Add Websockets streaming support for BLE REST API.

config BR2_PACKAGE_WEBLCM_PYTHON_UNAUTHENTICATED
	bool "Unauthenticated access support for weblcm"
	help
		Add unauthenticated access support, for example, for factory reset and reboot endpoints.  Due to security concerns, this should never be enabled unless requested by a customer, and preferably never enabled if WebLCM is exposed on a public/external zone interface.

config BR2_PACKAGE_WEBLCM_PYTHON_BIND_IP
	string "IP address to which the weblcm HTTP server binds"
	default "::"
	help
		IP address to bind to for the WebLCM HTTP server. Leave blank to bind to all IP addresses.

endif
```

## package/nbnsd/Config.in
```kconfig
config BR2_PACKAGE_NBNSD
	bool "nbnsd"
	help
	  A free and minimal NetBIOS Name Service responder daemon
      http://www.mostang.com/~davidm/nbnsd/
```

## package/node-ssl-shim/Config.in
```kconfig
config BR2_PACKAGE_NODE_SSL_SHIM
	bool "node ssl shim"
	select BR2_PACKAGE_OPENSSL
	help
	  Build Node.js OpenSSL shim for use with
	  building Node.js

	  https://github.com/sclorg/node-ssl-shim
```

## package/nodejs/Config.in.host
```kconfig
config BR2_PACKAGE_HOST_NODEJS
	bool "host nodejs tools for npm"
	help
	  Build nodejs for the host

	  https://nodejs.org/

if BR2_PACKAGE_HOST_NODEJS

config BR2_PACKAGE_NODEJS_VERSION_STRING
	string
	default "6.9.4"

endif
```

## package/openssl/Config.in
```kconfig
config BR2_PACKAGE_OPENSSL_FORCE_LIBOPENSSL
	bool

config BR2_PACKAGE_OPENSSL
	bool "openssl support"
	select BR2_PACKAGE_HAS_OPENSSL
	help
	  Select the desired ssl library provider.

if BR2_PACKAGE_OPENSSL

choice
	prompt "ssl library"
	default BR2_PACKAGE_LIBOPENSSL
	help
	  Select OpenSSL or OpenSSL-1.0.2 or OpenSSL-3.0 or LibreSSL.

config BR2_PACKAGE_LIBOPENSSL
	bool "openssl"
	select BR2_PACKAGE_ZLIB
	help
	  A collaborative effort to develop a robust, commercial-grade,
	  fully featured, and Open Source toolkit implementing the
	  Secure Sockets Layer (SSL v2/v3) and Transport Security
	  (TLS v1) as well as a full-strength general-purpose
	  cryptography library.

	  http://www.openssl.org/

	  Note: Some helper scripts need perl.

source "package/libopenssl/Config.in"

config BR2_PACKAGE_LIBOPENSSL_3_0
	bool "openssl 3.0"
	select BR2_PACKAGE_ZLIB
	help
		This is libopenssl-3.0.

source "package/libopenssl_3_0/Config.in"


config BR2_PACKAGE_LIBOPENSSL_1_0_2
	bool "openssl 1.0.2"
	select BR2_PACKAGE_ZLIB
	help
		This is libopenssl-1.0.2, which support FIPS.

source "package/libopenssl_1_0_2/Config.in"

config BR2_PACKAGE_LAIRD_OPENSSL_FIPS_BINARIES
	bool "Laird openssl-1.0.2 (or 3.0) fips binaries"
	select BR2_PACKAGE_ZLIB
	help
		This is Laird openssl FIPS binaries (1.0.2/3.0).

source "package/lrd/laird_openssl_fips-binaries/Config.in"

config BR2_PACKAGE_LIBRESSL
	bool "libressl"
	depends on !BR2_PACKAGE_OPENSSL_FORCE_LIBOPENSSL
	depends on BR2_TOOLCHAIN_HAS_THREADS
	# uClibc doesn't provide __register_atfork() without NPTL
	depends on !BR2_TOOLCHAIN_USES_UCLIBC || BR2_TOOLCHAIN_HAS_THREADS_NPTL
	help
	  LibreSSL is a version of the TLS/crypto stack forked from
	  OpenSSL in 2014, with goals of modernizing the codebase,
	  improving security, and applying best practice development
	  processes.

	  http://www.libressl.org/

source "package/libressl/Config.in"

# openssl from br2-external trees, if any
source "$BR2_BASE_DIR/.br2-external.in.openssl"

endchoice

config BR2_PACKAGE_HAS_OPENSSL
	bool

config BR2_PACKAGE_PROVIDES_OPENSSL
	string
	default "libopenssl" if BR2_PACKAGE_LIBOPENSSL
	default "libopenssl_1_0_2"  if BR2_PACKAGE_LIBOPENSSL_1_0_2
	default "libopenssl_3_0"  if BR2_PACKAGE_LIBOPENSSL_3_0
	default "libressl" if BR2_PACKAGE_LIBRESSL
	default "laird_openssl_fips-binaries"  if BR2_PACKAGE_LAIRD_OPENSSL_FIPS_BINARIES

endif

# ensure libopenssl is used for the host variant
config BR2_PACKAGE_PROVIDES_HOST_OPENSSL
	string
	default "host-libopenssl"
```

## package/prelink-cross/Config.in.host
```kconfig
config BR2_PACKAGE_HOST_PRELINK_CROSS
	bool "host prelink-cross"
	select BR2_PACKAGE_ELFUTILS
	help
	  Emulate a runtime linker for a given sysroot.

	  https://wiki.yoctoproject.org/wiki/Cross-Prelink
```

## package/python-cherrypy/Config.in
```kconfig
config BR2_PACKAGE_PYTHON_CHERRYPY
	bool "python-cherrypy"
	depends on BR2_PACKAGE_PYTHON3 # python-cheroot, python-portend
	select BR2_PACKAGE_PYTHON_CHEROOT # runtime
	select BR2_PACKAGE_PYTHON_PORTEND # runtime
	select BR2_PACKAGE_PYTHON3_PYEXPAT # runtime
	select BR2_PACKAGE_PYTHON_SIX # runtime
	select BR2_PACKAGE_PYTHON3_ZLIB # runtime
	select BR2_PACKAGE_PYTHON_ZC_LOCKFILE # runtime
	help
	  A minimalist web framework

	  http://www.cherrypy.org
```

## package/python-future/Config.in
```kconfig
config BR2_PACKAGE_PYTHON_FUTURE
	bool "python-future"
	help
	  futures is the Python package that provides ability to execute
	  Python 3 packages on Python 2
```

## package/python-jaraco-functools/Config.in
```kconfig
config BR2_PACKAGE_PYTHON_JARACO_FUNCTOOLS
	bool "python-jaraco-functools"
	depends on BR2_PACKAGE_PYTHON3 # python-more-itertools
	select BR2_PACKAGE_PYTHON_MORE_ITERTOOLS # runtime
	select BR2_PACKAGE_PYTHON_BACKPORTS_FUNCTOOLS_LRU_CACHE \
	       if BR2_PACKAGE_PYTHON # runtime
	help
	  Additional functools in the spirit of stdlib’s
	  functools.

	  https://github.com/jaraco/jaraco.functools
```

## package/python-portend/Config.in
```kconfig
config BR2_PACKAGE_PYTHON_PORTEND
	bool "python-portend"
	depends on BR2_PACKAGE_PYTHON3 # python-tempora
	help
	  TCP port monitoring utilities.

	  https://github.com/jaraco/portend
```

## package/python-slip-dbus/Config.in
```kconfig
config BR2_PACKAGE_PYTHON_SLIP_DBUS
	bool "python-slip-dbus"
	depends on BR2_USE_MMU # libglib2, gobject-introspection
	depends on BR2_PACKAGE_HOST_QEMU_ARCH_SUPPORTS # gobject-introspection
	depends on BR2_TOOLCHAIN_GCC_AT_LEAST_4_9 # gobject-introspection
	depends on BR2_TOOLCHAIN_USES_GLIBC # gobject-introspection
	depends on BR2_PACKAGE_DBUS # runtime
	depends on BR2_PACKAGE_PYTHON3 # gobject-introspection
	select BR2_PACKAGE_DBUS_PYTHON # runtime
	select BR2_PACKAGE_PYTHON_DECORATOR  # runtime
	select BR2_PACKAGE_PYTHON_GOBJECT  # runtime
	select BR2_PACKAGE_PYTHON_SIX # runtime
	help
	  A dbus.service.Object derivative that ends
	  itself after a certain time without being used and/or if there
	  are no clients anymore on the message bus, as well as
	  convenience functions and decorators for integrating a dbus
	  service with PolicyKit.

	  https://github.com/nphilipp/python-slip

comment "python-slip-dbus needs python3"
	depends on !BR2_PACKAGE_PYTHON3

comment "python-slip-dbus needs a glibc toolchain, gcc >= 4.9"
	depends on BR2_USE_MMU
	depends on BR2_PACKAGE_DBUS && BR2_PACKAGE_HOST_QEMU_ARCH_SUPPORTS
	depends on !BR2_TOOLCHAIN_USES_GLIBC || \
		!BR2_TOOLCHAIN_GCC_AT_LEAST_4_9
```

## package/python3-gobject/Config.in
```kconfig
config BR2_PACKAGE_PYTHON3_GOBJECT
	bool "python3-gobject"
	depends on BR2_USE_WCHAR # libglib2
	depends on BR2_TOOLCHAIN_HAS_THREADS # libglib2
	depends on BR2_USE_MMU # libglib2
	depends on BR2_PACKAGE_GOBJECT_INTROSPECTION
	depends on BR2_PACKAGE_PYTHON3
	select BR2_PACKAGE_LIBGLIB2
	help
	  Python bindings for the GLib/GObject library

	  https://wiki.gnome.org/action/show/Projects/PyGObject

comment "python3-gobject needs a toolchain w/ wchar, threads"
	depends on BR2_USE_MMU
	depends on !BR2_USE_WCHAR || !BR2_TOOLCHAIN_HAS_THREADS
```

## package/wifi-test-suite/Config.in
```kconfig
config BR2_PACKAGE_WIFI_TEST_SUITE
	bool "wifi_test_suite"
	help
	   The Wi-Fi Test Suit Linux Control Agent is a program
	   by the Wi-fi alliance that enables certification of
	   programs and devices.
	   https://github.com/Wi-FiTestSuite/Wi-FiTestSuite-Linux-DUT/
```

## toolchain/toolchain-external/toolchain-external-laird-arm/Config.in
```kconfig
comment "Laird toolchains available for Cortex-A + EABIhf & arm946ej-s EABI"
	depends on BR2_arm
	depends on !BR2_STATIC_LIBS

config BR2_TOOLCHAIN_EXTERNAL_LAIRD_ARM
	bool "Laird ARM 2018.02"
	depends on BR2_arm
	depends on BR2_ARM_CPU_ARMV7A || BR2_ARM_CPU_ARMV8A || BR2_ARM_CPU_ARMV6 || BR2_ARM_CPU_ARMV5  || BR2_ARM_CPU_ARMV4
	depends on BR2_HOSTARCH = "x86_64"
	depends on !BR2_STATIC_LIBS
	select BR2_TOOLCHAIN_EXTERNAL_GLIBC
	select BR2_TOOLCHAIN_HAS_SSP
	select BR2_TOOLCHAIN_HAS_NATIVE_RPC
	select BR2_INSTALL_LIBSTDCPP
	select BR2_TOOLCHAIN_HEADERS_AT_LEAST_4_19
	select BR2_TOOLCHAIN_GCC_AT_LEAST_7
	help
	  Laird toolchain for the ARM architecture. It uses:
	  GCC 7.4.0, GDB 8.2.0, glibc-2.28+, binutils 2.31.1.
```
