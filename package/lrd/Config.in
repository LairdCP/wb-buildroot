## package/lrd/Config.in
```kconfig
source "package/lrd/lrd-wireless-regdb/Config.in"
source "package/lrd/fipscheck/Config.in"
source "package/lrd/mc-mint/Config.in"
source "package/lrd/eventmon/Config.in"
source "package/lrd/fswatch/Config.in"
source "package/lrd/php_sdk/Config.in"
source "package/lrd/weblcm-python/Config.in"
source "package/lrd/dcal/Config.in"
source "package/lrd/dcas/Config.in"
source "package/lrd/libloragw/Config.in"
source "package/lrd/lrd-network-manager/Config.in"
source "package/lrd/lora-packet-forwarder/Config.in"
source "package/lrd/lrd-legacy/Config.in"
source "package/lrd/ttn-forwarder/Config.in"
source "package/lrd/lora-gateway-bridge/Config.in"
source "package/lrd/demo-gui/Config.in"
source "package/lrd/easycwmp/Config.in"
source "package/lrd/lrd-automount/Config.in"
source "package/lrd/lrd-usbgadget/Config.in"
source "package/lrd/lrd-encrypted-storage-toolkit/Config.in"
source "package/lrd/igconfd/Config.in"
source "package/lrd/lrd-bt-utils/Config.in"
source "package/lrd/igupd/Config.in"
source "package/lrd/lrd-userspace-examples/Config.in"
source "package/lrd/sdcsdk_nm/Config.in"
source "package/lrd/lrd-swupdate-client/Config.in"
source "package/lrd/ig-tty-utils/Config.in"
```

## package/lrd/adaptive_ww-binaries/Config.in
```kconfig
config BR2_PACKAGE_ADAPTIVE_WW_BINARIES
	bool "Summit Adaptive World Mode Binaries Installer"
	select BR2_PACKAGE_ADAPTIVE_WW if BR2_LRD_DEVEL_BUILD="y"

	help
	  Extracts adaptive_ww from adaptive_ww-arm release and installs them on the target.
```

## package/lrd/eventmon/Config.in
```kconfig
config BR2_PACKAGE_EVENTMON
	bool "eventmon"
	select BR2_PACKAGE_LIBNL
	help
	  Laird Event Monitor
```

## package/lrd/fips-check/Config.in
```kconfig
config BR2_PACKAGE_FIPS_CHECK
	bool "fips_check"
	help
	  FIPS Integrity Checker
```

## package/lrd/fipscheck/Config.in
```kconfig
config BR2_PACKAGE_FIPSCHECK
	bool "fipscheck"
	default y if BR2_LRD_FIPS_RADIO
	help
	  FIPS Integrity Checker

config BR2_PACKAGE_HOST_FIPSCHECK
	bool "host fipscheck"
	default y if BR2_LRD_FIPS_RADIO
	help
	  FIPS Integrity Checker
```

## package/lrd/firmware-binaries/Config.in
```kconfig
config BR2_PACKAGE_FIRMWARE_BINARIES
	bool "FIRMWARE Installer"
	select BR2_PACKAGE_LAIRD_FIRMWARE if BR2_LRD_DEVEL_BUILD="y"
	help
      Extracts the Laird wireless firmware binaries from an firmware release and install them on the target.

if BR2_PACKAGE_FIRMWARE_BINARIES

config BR2_FIRMWARE_BINARIES_480_0079
	bool "Sterling-LWB FCC"
    default n
	select BR2_PACKAGE_LAIRD_FIRMWARE_BCM4343 if BR2_LRD_DEVEL_BUILD="y"
	select BR2_PACKAGE_LRD_WIRELESS_REGDB if BR2_LRD_DEVEL_BUILD="y"

config BR2_FIRMWARE_BINARIES_480_0080
	bool "Sterling-LWB ETSI"
    default n
	select BR2_PACKAGE_LAIRD_FIRMWARE_BCM4343 if BR2_LRD_DEVEL_BUILD="y"
	select BR2_PACKAGE_LRD_WIRELESS_REGDB if BR2_LRD_DEVEL_BUILD="y"

config BR2_FIRMWARE_BINARIES_480_0081
	bool "Sterling-LWB5 FCC"
    default n
	select BR2_PACKAGE_LAIRD_FIRMWARE_BCM4339 if BR2_LRD_DEVEL_BUILD="y"
	select BR2_PACKAGE_LRD_WIRELESS_REGDB if BR2_LRD_DEVEL_BUILD="y"

config BR2_FIRMWARE_BINARIES_480_0082
	bool "Sterling-LWB5 ETSI"
    default n
	select BR2_PACKAGE_LAIRD_FIRMWARE_BCM4339 if BR2_LRD_DEVEL_BUILD="y"
	select BR2_PACKAGE_LRD_WIRELESS_REGDB if BR2_LRD_DEVEL_BUILD="y"

config BR2_FIRMWARE_BINARIES_480_0094
	bool "Sterling-LWB5 IC"
    default n
	select BR2_PACKAGE_LAIRD_FIRMWARE_BCM4339 if BR2_LRD_DEVEL_BUILD="y"
	select BR2_PACKAGE_LRD_WIRELESS_REGDB if BR2_LRD_DEVEL_BUILD="y"

config BR2_FIRMWARE_BINARIES_480_0095
	bool "Sterling-LWB5 JP"
    default n
	select BR2_PACKAGE_LAIRD_FIRMWARE_BCM4339 if BR2_LRD_DEVEL_BUILD="y"
	select BR2_PACKAGE_LRD_WIRELESS_REGDB if BR2_LRD_DEVEL_BUILD="y"

config BR2_FIRMWARE_BINARIES_480_0116
	bool "Sterling-LWB JP"
    default n
	select BR2_PACKAGE_LAIRD_FIRMWARE_BCM4343 if BR2_LRD_DEVEL_BUILD="y"
	select BR2_PACKAGE_LRD_WIRELESS_REGDB if BR2_LRD_DEVEL_BUILD="y"

config BR2_FIRMWARE_BINARIES_480_0108
	bool "Sterling-LWB-MFG"
    default n
	select BR2_PACKAGE_LAIRD_FIRMWARE_BCM4343_MFG if BR2_LRD_DEVEL_BUILD="y"
	select BR2_PACKAGE_LRD_WIRELESS_REGDB if BR2_LRD_DEVEL_BUILD="y"

config BR2_FIRMWARE_BINARIES_480_0109
	bool "Sterling-LWB5-MFG"
    default n
	select BR2_PACKAGE_LAIRD_FIRMWARE_BCM4339_MFG if BR2_LRD_DEVEL_BUILD="y"
	select BR2_PACKAGE_LRD_WIRELESS_REGDB if BR2_LRD_DEVEL_BUILD="y"

config BR2_FIRMWARE_BINARIES_930_0081
	bool "WL-FMAC"
    default n
	select BR2_PACKAGE_WL_FMAC if BR2_LRD_DEVEL_BUILD="y"
endif
```

## package/lrd/ig/Config.in
```kconfig
menu "Industrial Gateway"
    source "package/lrd/ig/igprovd/Config.in"
    source "package/lrd/ig/igconfd/Config.in"
    source "package/lrd/ig/ggsupport/Config.in"
    source "package/lrd/ig/igupd/Config.in"
    source "package/lrd/ig/deviced/Config.in"
endmenu
```

## package/lrd/ig/dbproxysvc/Config.in
```kconfig
config BR2_PACKAGE_DBPROXYSVC
	bool "dbproxysvc"
	help
	  DBus Proxy Service
	depends on BR2_PACKAGE_PYTHON
```

## package/lrd/ig/deviced/Config.in
```kconfig
config BR2_PACKAGE_DEVICED
	bool "deviced"
	depends on BR2_PACKAGE_PYTHON
	help
	  Laird Industrial Gateway Device Service
```

## package/lrd/ig/ggsupport/Config.in
```kconfig
config BR2_PACKAGE_GGSUPPORT
	bool "ggsupport"
	help
	  Laird Industrial Gateway Greengrass Support
```

## package/lrd/ig/igprovd/Config.in
```kconfig
config BR2_PACKAGE_IGPROVD
	bool "igprovd"
	help
	  Laird Industrial Gateway Provisioning Service
	depends on BR2_PACKAGE_PYTHON
```

## package/lrd/igconfd/Config.in
```kconfig
config BR2_PACKAGE_IGCONFD
	bool "igconfd"
	select BR2_PACKAGE_PYTHON3
	select BR2_PACKAGE_GOBJECT_INTROSPECTION
	select BR2_PACKAGE_PYTHON3_GOBJECT
	select BR2_PACKAGE_PYTHON3_ZLIB
	select BR2_PACKAGE_PYTHON_SYSTEMD
	select BR2_PACKAGE_DBUS_PYTHON
	select BR2_PACKAGE_PYTHON_REQUESTS
	help
	  Laird Industrial Gateway Configuration Service
```

## package/lrd/igsdk/Config.in
```kconfig
config BR2_PACKAGE_IGSDK
	bool "Laird Industrial Gateway SDK"
	select BR2_PACKAGE_PYTHON3
	select BR2_PACKAGE_GOBJECT_INTROSPECTION
	select BR2_PACKAGE_PYTHON3_GOBJECT

	help
	  Laird Industrial Gateway SDK
```

## package/lrd/igupd/Config.in
```kconfig
config BR2_PACKAGE_IGUPD
	bool "igupd"
	select BR2_PACKAGE_PYTHON3
	select BR2_PACKAGE_GOBJECT_INTROSPECTION
	select BR2_PACKAGE_PYTHON_GOBJECT
	select BR2_PACKAGE_PYTHON_PSUTIL
	select BR2_PACKAGE_PYTHON_PYUDEV
	help
	  Laird Industrial Gateway Update Service
```

## package/lrd/lora-packet-forwarder/Config.in
```kconfig
config BR2_PACKAGE_LORA_PACKET_FORWARDER
	bool "lora-packet-forwarder"
	help
      Semtech packet forwarder
```

## package/lrd/lrd-automount/Config.in
```kconfig
menuconfig BR2_PACKAGE_LRD_AUTOMOUNT
	bool "lrd-automount"
	help
	  Laird USB Automount

if BR2_PACKAGE_LRD_AUTOMOUNT
config BR2_PACKAGE_LRD_AUTOMOUNT_USB
	bool "USB Drive Automount"
	default y

config BR2_PACKAGE_LRD_AUTOMOUNT_MMC
	bool "SD Card Automount"
	default y

endif
```

## package/lrd/lrd-encrypted-storage-toolkit/Config.in
```kconfig
config BR2_PACKAGE_LRD_ENCRYPTED_STORAGE_TOOLKIT
	bool "lrd encrypted storage toolkit"
	select BR2_PACKAGE_KEYUTILS
	select BR2_PACKAGE_RSYNC
	select BR2_PACKAGE_FSCRYPTCTL
	select BR2_PACKAGE_LRD_FACTORY_RESET_TOOLKIT
	help
	Toolkit to begin prototyping implemention of
	Laird's U-Boot encryption coupled with Linux
	per directory encryption. This is part of
	Laird's Chain of Trust architecture.
```

## package/lrd/lrd-factory-reset-toolkit/Config.in
```kconfig
config BR2_PACKAGE_LRD_FACTORY_RESET_TOOLKIT
	bool "lrd factory reset toolkit"
	help
	Toolkit to check and do factory reset
```

## package/lrd/lrd-legacy/Config.in
```kconfig
config BR2_PACKAGE_LRD_LEGACY
	bool "lrd-legacy"
	select BR2_PACKAGE_DHCPCD
	select BR2_PACKAGE_OPENRESOLV
	help
	  Laird legacy software
```

## package/lrd/lrd-radio/Config.in
```kconfig
choice
	prompt "Radio Stack"

	config BR2_LRD_NO_RADIO
		bool "None"

	config BR2_LRD_SOM60_RADIO
		bool "SOM60 Radio"
		select BR2_PACKAGE_SOM60_FIRMWARE_BINARIES
		select BR2_PACKAGE_SUMMIT_SUPPLICANT_BINARIES
		select BR2_PACKAGE_LINUX_BACKPORTS
		select BR2_PACKAGE_ADAPTIVE_WW_BINARIES
		select BR2_PACKAGE_LRD_NETWORK_MANAGER

	config BR2_LRD_SOM60_FIPS_RADIO
		bool "SOM60 FIPS Radio"
		select BR2_PACKAGE_SOM60_FIRMWARE_BINARIES
		select BR2_PACKAGE_SUMMIT_SUPPLICANT_BINARIES
		select BR2_PACKAGE_LINUX_BACKPORTS
		select BR2_PACKAGE_ADAPTIVE_WW_BINARIES
		select BR2_PACKAGE_LRD_NETWORK_MANAGER
		select BR2_PACKAGE_UBOOT_TOOLS
		select BR2_PACKAGE_UBOOT_TOOLS_DUMPIMAGE

	config BR2_LRD_WB50N_SYSD_RADIO
		bool "WB50N SYSD Radio"
		select BR2_PACKAGE_WB50N_FIRMWARE_BINARIES
		select BR2_PACKAGE_SUMMIT_SUPPLICANT_BINARIES
		select BR2_PACKAGE_LINUX_BACKPORTS
		select BR2_PACKAGE_LRD_NETWORK_MANAGER

	config BR2_LRD_WB50N_SYSD_FIPS_RADIO
		bool "WB50N SYSD FIPS_Radio"
		select BR2_PACKAGE_WB50N_FIRMWARE_BINARIES
		select BR2_PACKAGE_SUMMIT_SUPPLICANT_BINARIES
		select BR2_PACKAGE_LINUX_BACKPORTS
		select BR2_PACKAGE_LRD_NETWORK_MANAGER
		select BR2_PACKAGE_UBOOT_TOOLS
		select BR2_PACKAGE_UBOOT_TOOLS_DUMPIMAGE

	config BR2_LRD_WB50N_LEGACY_RADIO
		bool "WB50N Legacy Radio"
		select BR2_PACKAGE_WB50N_FIRMWARE_BINARIES
		select BR2_PACKAGE_WB_LEGACY_SUMMIT_SUPPLICANT_BINARIES
		select BR2_PACKAGE_LINUX_BACKPORTS

	config BR2_LRD_WB45N_RADIO
		bool "WB45N Radio"
		select BR2_PACKAGE_WB45N_FIRMWARE_BINARIES
		select BR2_PACKAGE_WB_LEGACY_SUMMIT_SUPPLICANT_BINARIES
endchoice

comment "Please config openssl in Target packages->Libraries/Crypto/Openssl"
depends on !BR2_LRD_NO_RADIO
comment "Please config linux-backports in Target packages->Hardware handling->linux-backports"
depends on !BR2_LRD_NO_RADIO && !BR2_LRD_WB45N_RADIO
comment "Please config lrd-network-manager in Laird->Packages->lrd-networkmanager"
depends on !BR2_LRD_NO_RADIO && !BR2_LRD_WB50N_LEGACY_RADIO && !BR2_LRD_WB45N_RADIO

config BR2_PACKAGE_LRD_60_RADIO_STACK_VERSION_VALUE
	string "SOM60 radio stack version"
	depends on BR2_LRD_SOM60_RADIO || BR2_LRD_SOM60_FIPS_RADIO
	default "8.1.0.5"
	help
	Version number for radio packages.

config BR2_PACKAGE_LRD_50_RADIO_STACK_VERSION_VALUE
	string "WB radio stack version"
	depends on BR2_LRD_WB50N_SYSD_RADIO || BR2_LRD_WB50N_SYSD_FIPS_RADIO || BR2_LRD_WB50N_LEGACY_RADIO
	default "8.1.0.5"
	help
	  Version number for radio packages.

config BR2_PACKAGE_LRD_45_RADIO_STACK_VERSION_VALUE
	string "WB radio stack version"
	depends on BR2_LRD_WB45N_RADIO
	default "8.1.0.5"
	help
	  Version number for radio packages.

config BR2_PACKAGE_LRD_RADIO_STACK_VERSION_VALUE
	string
	depends on !BR2_LRD_NO_RADIO
	default BR2_PACKAGE_LRD_60_RADIO_STACK_VERSION_VALUE if BR2_LRD_SOM60_RADIO || BR2_LRD_SOM60_FIPS_RADIO
	default BR2_PACKAGE_LRD_50_RADIO_STACK_VERSION_VALUE if BR2_LRD_WB50N_SYSD_RADIO || BR2_LRD_WB50N_SYSD_FIPS_RADIO || BR2_LRD_WB50N_LEGACY_RADIO
	default BR2_PACKAGE_LRD_45_RADIO_STACK_VERSION_VALUE if BR2_LRD_WB45N_RADIO

if BR2_LRD_SOM60_RADIO || BR2_LRD_SOM60_FIPS_RADIO
source "package/lrd/lrd-radio/summit-supplicant-binaries/Config.in"
source "package/lrd/lrd-radio/som60-firmware-binaries/Config.in"
source "package/lrd/lrd-radio/adaptive_ww-binaries/Config.in"
source "package/lrd/lrd-radio/mfg60n-binaries/Config.in"
endif

if BR2_LRD_WB50N_SYSD_RADIO || BR2_LRD_WB50N_SYSD_FIPS_RADIO
source "package/lrd/lrd-radio/summit-supplicant-binaries/Config.in"
source "package/lrd/lrd-radio/wb50n-firmware-binaries/Config.in"
source "package/lrd/lrd-radio/reg50n-binaries/Config.in"
endif

if BR2_LRD_WB50N_LEGACY_RADIO
source "package/lrd/lrd-radio/wb-legacy-summit-supplicant-binaries/Config.in"
source "package/lrd/lrd-radio/wb50n-firmware-binaries/Config.in"
source "package/lrd/lrd-radio/reg50n-binaries/Config.in"
endif

if BR2_LRD_WB45N_RADIO
source "package/lrd/lrd-radio/wb-legacy-summit-supplicant-binaries/Config.in"
source "package/lrd/lrd-radio/wb45n-firmware-binaries/Config.in"
source "package/lrd/lrd-radio/reg45n-binaries/Config.in"
endif
```

## package/lrd/lrd-radio/adaptive_bt-binaries/Config.in
```kconfig
config BR2_PACKAGE_ADAPTIVE_BT_BINARIES
	bool "Adaptive Bluetooth Binaries Installer"
	select BR2_PACKAGE_LIBNL
	select BR2_PACKAGE_BLUEZ5_UTILS
	select BR2_PACKAGE_ADAPTIVE_BT if BR2_LRD_DEVEL_BUILD="y"

	help
	  Extracts source from adaptive_bt-src release, compile, and installs adaptive_bt on the target.
```

## package/lrd/lrd-radio/adaptive_ww-binaries/Config.in
```kconfig
config BR2_PACKAGE_ADAPTIVE_WW_BINARIES
	bool "Summit Adaptive World Mode Binaries Installer"
	select BR2_PACKAGE_LIBNL
	select BR2_PACKAGE_OPENSSL
	select BR2_PACKAGE_ADAPTIVE_WW if BR2_LRD_DEVEL_BUILD="y"

	help
	  Extracts adaptive_ww from adaptive_ww-arm release and installs them on the target.

if BR2_PACKAGE_ADAPTIVE_WW_BINARIES
config BR2_PACKAGE_ADAPTIVE_WW_BINARIES_REGPWRDB
	bool "Adaptive World Mode Regulatory Powers Database"
	default y
	help
		A default Adaptive World Mode Regulatory Powers Database
endif
```

## package/lrd/lrd-radio/mfg60n-arm-eabihf-binaries/Config.in
```kconfig
config BR2_PACKAGE_MFG60N_ARM_EABIHF_BINARIES
	bool "60 series manufacturing tools binaries"
	default n
	select BR2_PACKAGE_LIBEDIT
	help
	  This package installs 60 series manufacturing tools.
```

## package/lrd/lrd-radio/summit-supplicant-binaries/Config.in
```kconfig
config BR2_PACKAGE_SUMMIT_SUPPLICANT_BINARIES
	bool "SOM60 Summit Supplicant ARM EABIHF Binaries Installer"
	select BR2_PACKAGE_LIBNL
	select BR2_PACKAGE_DBUS
	select BR2_PACKAGE_OPENSSL
	select BR2_PACKAGE_SDCSUPP if BR2_LRD_DEVEL_BUILD="y"
	select BR2_PACKAGE_SDCSUPP_WPA_CLI if BR2_LRD_DEVEL_BUILD="y"
	help
	  Extracts sdcsupp, wpa_cli binaries from summit supplicant release and install them on the target.
```
