## configs/som60x2sd_defconfig
```kconfig
BR2_arm=y
BR2_cortex_a5=y
BR2_ARM_ENABLE_VFP=y
BR2_WGET="wget --passive-ftp -nd"
BR2_DL_DIR="$(HOME)/.br2_dl_dir"
BR2_JLEVEL=16
BR2_CCACHE=y
BR2_CCACHE_DIR="$(BR2_DL_DIR)/.buildroot-ccache"
BR2_OPTIMIZE_3=y
BR2_PACKAGE_OVERRIDE_FILE="$(TOPDIR)/board/laird/som60/som60-local.mk"
BR2_TOOLCHAIN_EXTERNAL=y
BR2_TOOLCHAIN_EXTERNAL_LAIRD_ARM=y
BR2_TARGET_GENERIC_HOSTNAME="summit"
BR2_TARGET_GENERIC_ISSUE="Laird"
BR2_INIT_SYSTEMD=y
BR2_ROOTFS_DEVICE_TABLE="board/laird/device_table.txt"
BR2_TARGET_GENERIC_ROOT_PASSWD="summit"
BR2_TARGET_GENERIC_GETTY_PORT="tty0"
BR2_ENABLE_LOCALE_WHITELIST="en_US"
BR2_ROOTFS_POST_BUILD_SCRIPT="board/laird/som60/post_build.sh"
BR2_ROOTFS_POST_IMAGE_SCRIPT="board/laird/som60/post_image.sh"
BR2_ROOTFS_POST_SCRIPT_ARGS="som60sd board/laird/configs-common/keys"
BR2_LINUX_KERNEL=y
BR2_LINUX_KERNEL_DEFCONFIG="som60"
BR2_LINUX_KERNEL_IMAGE_TARGET_CUSTOM=y
BR2_LINUX_KERNEL_IMAGE_TARGET_NAME="Image"
BR2_LINUX_KERNEL_DTS_SUPPORT=y
BR2_LINUX_KERNEL_INTREE_DTS_NAME="at91-dvk_som60x2"
BR2_PACKAGE_BUSYBOX_CONFIG="$(TOPDIR)/board/laird/configs-common/busybox.config"
BR2_PACKAGE_ALSA_UTILS=y
BR2_PACKAGE_ALSA_UTILS_APLAY=y
BR2_PACKAGE_ALSA_UTILS_SPEAKER_TEST=y
BR2_PACKAGE_BZIP2=y
BR2_PACKAGE_GDB=y
BR2_PACKAGE_LSOF=y
BR2_PACKAGE_NETPERF=y
BR2_PACKAGE_STRACE=y
BR2_PACKAGE_TRACE_CMD=y
BR2_PACKAGE_WHETSTONE=y
BR2_PACKAGE_WIFI_TEST_SUITE=y
BR2_PACKAGE_MTD=y
BR2_PACKAGE_BITSTREAM_VERA=y
BR2_PACKAGE_LIBERATION=y
BR2_PACKAGE_MINEHUNT=y
BR2_PACKAGE_FB_TEST_APP=y
BR2_PACKAGE_LIBPLANES=y
BR2_PACKAGE_QT5=y
BR2_PACKAGE_QT5BASE_SQLITE_QT=y
BR2_PACKAGE_QT5BASE_DEFAULT_QPA="linuxfb"
BR2_PACKAGE_QT5BASE_FONTCONFIG=y
BR2_PACKAGE_QT5BASE_GIF=y
BR2_PACKAGE_QT5BASE_JPEG=y
BR2_PACKAGE_QT5BASE_PNG=y
BR2_PACKAGE_QT5BASE_ICU=y
BR2_PACKAGE_QT5BASE_TSLIB=y
BR2_PACKAGE_QT5CHARTS=y
BR2_PACKAGE_QT5CONNECTIVITY=y
BR2_PACKAGE_QT5IMAGEFORMATS=y
BR2_PACKAGE_QT5LOCATION=y
BR2_PACKAGE_QT5QUICKCONTROLS=y
BR2_PACKAGE_QT5QUICKCONTROLS2=y
BR2_PACKAGE_QT5SCRIPT=y
BR2_PACKAGE_QT5SENSORS=y
BR2_PACKAGE_QT5SERIALBUS=y
BR2_PACKAGE_QT5SVG=y
BR2_PACKAGE_QT5QUICK1D=y
BR2_PACKAGE_DBUS_PYTHON=y
BR2_PACKAGE_DEVMEM2=y
BR2_PACKAGE_EVTEST=y
BR2_PACKAGE_I2C_TOOLS=y
BR2_PACKAGE_LINUXCONSOLETOOLS=y
BR2_PACKAGE_MEMTESTER=y
BR2_PACKAGE_SETSERIAL=y
BR2_PACKAGE_SREDIRD=y
BR2_PACKAGE_STATSERIAL=y
BR2_PACKAGE_UBOOT_TOOLS=y
BR2_PACKAGE_LUA=y
BR2_PACKAGE_PYTHON3_SSL=y
BR2_PACKAGE_PYTHON_CHERRYPY=y
BR2_PACKAGE_PYTHON3_GOBJECT=y
BR2_PACKAGE_PYTHON_SYSTEMD=y
BR2_PACKAGE_LZO=y
BR2_PACKAGE_CA_CERTIFICATES=y
BR2_PACKAGE_CRYPTODEV=y
BR2_PACKAGE_LIBOPENSSL_BIN=y
BR2_PACKAGE_SQLITE=y
BR2_PACKAGE_LIBCONFIG=y
BR2_PACKAGE_CAIRO=y
BR2_PACKAGE_CAIRO_PS=y
BR2_PACKAGE_CAIRO_SCRIPT=y
BR2_PACKAGE_CAIRO_SVG=y
BR2_PACKAGE_CAIRO_TEE=y
BR2_PACKAGE_CAIRO_XML=y
BR2_PACKAGE_LIBDRM=y
BR2_PACKAGE_LIBDRM_INSTALL_TESTS=y
BR2_PACKAGE_LIBHID=y
BR2_PACKAGE_LIBINPUT=y
BR2_PACKAGE_CJSON=y
BR2_PACKAGE_JSON_C=y
BR2_PACKAGE_LIBXMLPP=y
BR2_PACKAGE_LIBCURL=y
BR2_PACKAGE_LIBTIRPC=y
BR2_PACKAGE_GOBJECT_INTROSPECTION=y
BR2_PACKAGE_LIBDAEMON=y
BR2_PACKAGE_LIBEDIT=y
BR2_PACKAGE_BLUEZ5_UTILS=y
BR2_PACKAGE_BLUEZ5_UTILS_OBEX=y
BR2_PACKAGE_BLUEZ5_UTILS_CLIENT=y
BR2_PACKAGE_BLUEZ5_UTILS_EXPERIMENTAL=y
BR2_PACKAGE_BLUEZ5_UTILS_TEST=y
BR2_PACKAGE_BRIDGE_UTILS=y
BR2_PACKAGE_CAN_UTILS=y
BR2_PACKAGE_CHRONY=y
BR2_PACKAGE_CONNTRACK_TOOLS=y
BR2_PACKAGE_DNSMASQ=y
# BR2_PACKAGE_DNSMASQ_TFTP is not set
BR2_PACKAGE_DNSMASQ_DNSSEC=y
BR2_PACKAGE_DROPBEAR=y
BR2_PACKAGE_ETHTOOL=y
BR2_PACKAGE_FIREWALLD=y
# BR2_PACKAGE_IFUPDOWN_SCRIPTS is not set
BR2_PACKAGE_IPERF=y
BR2_PACKAGE_IPERF3=y
BR2_PACKAGE_IPROUTE2=y
BR2_PACKAGE_IPSEC_TOOLS=y
# BR2_PACKAGE_IPSEC_TOOLS_STATS is not set
BR2_PACKAGE_IW=y
BR2_PACKAGE_MII_DIAG=y
BR2_PACKAGE_NDISC6=y
BR2_PACKAGE_NDISC6_NAME2ADDR=y
BR2_PACKAGE_NDISC6_NDISC6=y
BR2_PACKAGE_NDISC6_RDISC6=y
BR2_PACKAGE_NDISC6_RDNSSD=y
BR2_PACKAGE_NDISC6_RLTRACEROUTE6=y
BR2_PACKAGE_NDISC6_TCPTRACEROUTE6=y
BR2_PACKAGE_NDISC6_TCPSPRAY=y
BR2_PACKAGE_NETCAT=y
BR2_PACKAGE_NETSTAT_NAT=y
BR2_PACKAGE_PPPD=y
BR2_PACKAGE_RSYNC=y
BR2_PACKAGE_TCPDUMP=y
BR2_PACKAGE_LOCKFILE_PROGS=y
BR2_PACKAGE_SWUPDATE=y
BR2_PACKAGE_SWUPDATE_CONFIG="board/laird/som60/configs/swupdate.config"
# BR2_PACKAGE_SWUPDATE_INSTALL_WEBSITE is not set
BR2_PACKAGE_SYSTEMD_HIBERNATE=y
# BR2_PACKAGE_SYSTEMD_HWDB is not set
BR2_PACKAGE_SYSTEMD_LOGIND=y
# BR2_PACKAGE_SYSTEMD_MYHOSTNAME is not set
# BR2_PACKAGE_SYSTEMD_NETWORKD is not set
# BR2_PACKAGE_SYSTEMD_RESOLVED is not set
# BR2_PACKAGE_SYSTEMD_TIMESYNCD is not set
# BR2_PACKAGE_SYSTEMD_VCONSOLE is not set
BR2_PACKAGE_UTIL_LINUX_HWCLOCK=y
BR2_TARGET_UBOOT=y
BR2_TARGET_UBOOT_BUILD_SYSTEM_KCONFIG=y
BR2_TARGET_UBOOT_CUSTOM_VERSION=y
BR2_TARGET_UBOOT_CUSTOM_VERSION_VALUE="2018.01"
BR2_TARGET_UBOOT_BOARD_DEFCONFIG="som60x2sd"
BR2_TARGET_UBOOT_NEEDS_DTC=y
# BR2_TARGET_UBOOT_FORMAT_BIN is not set
BR2_TARGET_UBOOT_FORMAT_ITB=y
BR2_TARGET_UBOOT_SPL=y
BR2_TARGET_UBOOT_SPL_NAME="spl/u-boot-spl-nodtb.bin spl/u-boot-spl.dtb"
BR2_PACKAGE_HOST_CRYPTSETUP=y
BR2_PACKAGE_HOST_E2FSPROGS=y
BR2_PACKAGE_HOST_GENIMAGE=y
BR2_PACKAGE_HOST_MTD=y
BR2_PACKAGE_HOST_UBOOT_TOOLS=y
BR2_PACKAGE_HOST_UBOOT_TOOLS_FIT_SUPPORT=y
BR2_PACKAGE_HOST_UBOOT_TOOLS_FIT_SIGNATURE_SUPPORT=y
BR2_LRD_SOM60_RADIO=y
BR2_PACKAGE_LRD_RADIO_STACK_VERSION_VALUE="7.0.0.296"
BR2_PACKAGE_MC_MINT=y
BR2_PACKAGE_LRD_AUTOMOUNT=y
# BR2_PACKAGE_LRD_AUTOMOUNT_MMC is not set
BR2_PACKAGE_LRD_USBGADGET=y
```

## configs/sterling_supplicant-arm_defconfig
```kconfig
BR2_arm=y
BR2_WGET="wget --passive-ftp -nd"
BR2_DL_DIR="$(HOME)/.br2_dl_dir"
BR2_CCACHE=y
BR2_CCACHE_DIR="$(BR2_DL_DIR)/.buildroot-ccache"
BR2_PACKAGE_OVERRIDE_FILE="$(TOPDIR)/board/laird/supplicant/sterling_supplicant-local.mk"
BR2_TOOLCHAIN_EXTERNAL=y
BR2_TOOLCHAIN_EXTERNAL_LAIRD_COMPONENT=y
BR2_ROOTFS_SKELETON_CUSTOM=y
BR2_ROOTFS_SKELETON_CUSTOM_PATH="$(TOPDIR)/board/laird/skeleton-empty"
BR2_INIT_NONE=y
BR2_ROOTFS_DEVICE_TABLE=""
BR2_ROOTFS_POST_IMAGE_SCRIPT="board/laird/supplicant/post_image.sh"
# BR2_PACKAGE_BUSYBOX is not set
BR2_PACKAGE_DBUS=y
BR2_PACKAGE_OPENSSL=y
BR2_PACKAGE_LIBOPENSSL_1_0_2=y
BR2_PACKAGE_WPA_SUPPLICANT=y
BR2_PACKAGE_WPA_SUPPLICANT_AP_SUPPORT=y
BR2_PACKAGE_WPA_SUPPLICANT_AUTOSCAN=y
BR2_PACKAGE_WPA_SUPPLICANT_EAP=y
BR2_PACKAGE_WPA_SUPPLICANT_DEBUG_SYSLOG=y
BR2_PACKAGE_WPA_SUPPLICANT_CLI=y
BR2_PACKAGE_WPA_SUPPLICANT_PASSPHRASE=y
BR2_PACKAGE_WPA_SUPPLICANT_DBUS=y
BR2_PACKAGE_WPA_SUPPLICANT_DBUS_INTROSPECTION=y
# BR2_TARGET_ROOTFS_TAR is not set
```

## configs/sterling_supplicant-x86_defconfig
```kconfig
BR2_WGET="wget --passive-ftp -nd"
BR2_DL_DIR="$(TOPDIR)/../archive"
BR2_JLEVEL=16
BR2_PACKAGE_OVERRIDE_FILE="$(TOPDIR)/board/laird/sterling_supplicant-x86/sterling_supplicant-x86-local.mk"
BR2_TOOLCHAIN_EXTERNAL=y
BR2_TOOLCHAIN_EXTERNAL_CUSTOM_PREFIX="i586-laird-linux-gnu"
BR2_TOOLCHAIN_EXTERNAL_GCC_4_8=y
BR2_TOOLCHAIN_EXTERNAL_HEADERS_3_0=y
BR2_TOOLCHAIN_EXTERNAL_CUSTOM_GLIBC=y
BR2_TOOLCHAIN_EXTERNAL_CXX=y
BR2_ROOTFS_SKELETON_CUSTOM=y
BR2_ROOTFS_SKELETON_CUSTOM_PATH="system/skeleton"
BR2_INIT_NONE=y
BR2_ROOTFS_DEVICE_CREATION_STATIC=y
BR2_ROOTFS_DEVICE_TABLE=""
BR2_ROOTFS_STATIC_DEVICE_TABLE=""
BR2_ROOTFS_POST_BUILD_SCRIPT="board/laird/sterling_supplicant-x86/post_build.sh"
BR2_ROOTFS_POST_IMAGE_SCRIPT="board/laird/sterling_supplicant-x86/post_image.sh"
# BR2_PACKAGE_BUSYBOX is not set
BR2_PACKAGE_DBUS=y
BR2_PACKAGE_OPENSSL=y
BR2_PACKAGE_LIBEDIT=y
BR2_PACKAGE_CRDA=y
BR2_PACKAGE_WPA_SUPPLICANT=y
BR2_PACKAGE_WPA_SUPPLICANT_AP_SUPPORT=y
BR2_PACKAGE_WPA_SUPPLICANT_AUTOSCAN=y
BR2_PACKAGE_WPA_SUPPLICANT_EAP=y
BR2_PACKAGE_WPA_SUPPLICANT_DEBUG_SYSLOG=y
BR2_PACKAGE_WPA_SUPPLICANT_CLI=y
BR2_PACKAGE_WPA_SUPPLICANT_PASSPHRASE=y
BR2_PACKAGE_WPA_SUPPLICANT_DBUS_NEW=y
BR2_PACKAGE_WPA_SUPPLICANT_DBUS_INTROSPECTION=y
BR2_TARGET_ROOTFS_TAR_BZIP2=y
```
