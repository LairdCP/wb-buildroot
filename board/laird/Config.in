## configs/firmware_defconfig
```kconfig
BR2_arm=y
BR2_WGET="wget --passive-ftp -nd"
BR2_DL_DIR="$(HOME)/.br2_dl_dir"
BR2_CCACHE=y
BR2_CCACHE_DIR="$(BR2_DL_DIR)/.buildroot-ccache"
BR2_TOOLCHAIN_EXTERNAL=y
BR2_TOOLCHAIN_EXTERNAL_CUSTOM=y
BR2_TOOLCHAIN_EXTERNAL_CUSTOM_PREFIX="arm-laird-linux-gnueabi"
BR2_TOOLCHAIN_EXTERNAL_GCC_4_8=y
BR2_TOOLCHAIN_EXTERNAL_HEADERS_3_15=y
BR2_TOOLCHAIN_EXTERNAL_CUSTOM_GLIBC=y
# BR2_TOOLCHAIN_EXTERNAL_INET_RPC is not set
BR2_TOOLCHAIN_EXTERNAL_CXX=y
BR2_ROOTFS_SKELETON_CUSTOM=y
BR2_ROOTFS_SKELETON_CUSTOM_PATH="$(TOPDIR)/board/laird/skeleton-empty"
BR2_INIT_NONE=y
BR2_ROOTFS_DEVICE_TABLE=""
BR2_ROOTFS_POST_IMAGE_SCRIPT="board/laird/firmware/post_image.sh"
# BR2_PACKAGE_BUSYBOX is not set
BR2_PACKAGE_WIRELESS_REGDB=y
# BR2_TARGET_ROOTFS_TAR is not set
BR2_PACKAGE_LRD_WIRELESS_REGDB=y
BR2_PACKAGE_LAIRD_FIRMWARE=y
BR2_PACKAGE_LAIRD_FIRMWARE_AR6003=y
BR2_PACKAGE_LAIRD_FIRMWARE_AR6004=y
BR2_PACKAGE_LAIRD_FIRMWARE_BCM4343=y
BR2_PACKAGE_LAIRD_FIRMWARE_BCM4339=y
BR2_PACKAGE_LAIRD_FIRMWARE_BCM4373=y
BR2_PACKAGE_LAIRD_FIRMWARE_LRDMWL_ST60_SDIO_UART=y
BR2_PACKAGE_LAIRD_FIRMWARE_LRDMWL_ST60_SDIO_SDIO=y
BR2_PACKAGE_LAIRD_FIRMWARE_LRDMWL_ST60_PCIE_UART=y
BR2_PACKAGE_LAIRD_FIRMWARE_LRDMWL_ST60_PCIE_USB=y
BR2_PACKAGE_LAIRD_FIRMWARE_LRDMWL_ST60_USB_UART=y
BR2_PACKAGE_LAIRD_FIRMWARE_LRDMWL_ST60_USB_USB=y
BR2_PACKAGE_LAIRD_FIRMWARE_LRDMWL_SU60_SDIO_UART=y
BR2_PACKAGE_LAIRD_FIRMWARE_LRDMWL_SU60_SDIO_SDIO=y
BR2_PACKAGE_LAIRD_FIRMWARE_LRDMWL_SU60_PCIE_UART=y
BR2_PACKAGE_LAIRD_FIRMWARE_LRDMWL_SU60_PCIE_USB=y
BR2_PACKAGE_LAIRD_FIRMWARE_LRDMWL_SU60_USB_UART=y
BR2_PACKAGE_LAIRD_FIRMWARE_LRDMWL_SU60_USB_USB=y
BR2_PACKAGE_LAIRD_FIRMWARE_LRDMWL_SOM60=y
BR2_PACKAGE_LAIRD_FIRMWARE_BT=y
```

## configs/laird_openssl_fips-arm-eabihf_defconfig
```kconfig
BR2_arm=y
BR2_cortex_a5=y
BR2_ARM_ENABLE_VFP=y
BR2_ARM_FPU_VFPV2=y
BR2_ARM_INSTRUCTIONS_THUMB2=y
BR2_WGET="wget --passive-ftp -nd"
BR2_DL_DIR="$(TOPDIR)/../archive"
BR2_JLEVEL=16
BR2_CCACHE=y
BR2_CCACHE_DIR="$(BR2_DL_DIR)/.buildroot-ccache"
BR2_TOOLCHAIN_EXTERNAL=y
BR2_TOOLCHAIN_EXTERNAL_CUSTOM=y
BR2_TOOLCHAIN_EXTERNAL_CUSTOM_PREFIX="arm-buildroot-linux-gnueabihf"
BR2_TOOLCHAIN_EXTERNAL_GCC_6=y
BR2_TOOLCHAIN_EXTERNAL_HEADERS_4_1=y
BR2_TOOLCHAIN_EXTERNAL_CUSTOM_GLIBC=y
BR2_TOOLCHAIN_EXTERNAL_CXX=y
BR2_ROOTFS_SKELETON_CUSTOM=y
BR2_ROOTFS_SKELETON_CUSTOM_PATH="$(TOPDIR)/board/laird/skeleton-empty"
BR2_INIT_NONE=y
BR2_ROOTFS_DEVICE_TABLE=""
BR2_ROOTFS_POST_IMAGE_SCRIPT="board/laird/laird-openssl-fips/post_image.sh"
BR2_ROOTFS_POST_SCRIPT_ARGS="laird_openssl_fips-arm-eabihf"
# BR2_PACKAGE_BUSYBOX is not set
BR2_PACKAGE_OPENSSL=y
BR2_PACKAGE_LIBOPENSSL_1_0_2=y
BR2_PACKAGE_LIBOPENSSL_BIN=y
# BR2_TARGET_ROOTFS_TAR is not set
BR2_PACKAGE_OPENSSL_FIPS=y
BR2_PACKAGE_LAIRD_OPENSSL_FIPS=y
```

## configs/msd-x86_defconfig
```kconfig
BR2_WGET="wget --passive-ftp -nd"
BR2_DL_DIR="$(TOPDIR)/../archive"
BR2_JLEVEL=16
BR2_TOOLCHAIN_EXTERNAL=y
BR2_TOOLCHAIN_EXTERNAL_CUSTOM_PREFIX="i586-laird-linux-gnu"
BR2_TOOLCHAIN_EXTERNAL_GCC_4_8=y
BR2_TOOLCHAIN_EXTERNAL_HEADERS_3_0=y
BR2_TOOLCHAIN_EXTERNAL_CUSTOM_GLIBC=y
BR2_TOOLCHAIN_EXTERNAL_CXX=y
BR2_ROOTFS_SKELETON_CUSTOM=y
BR2_ROOTFS_SKELETON_CUSTOM_PATH="system/skeleton"
BR2_INIT_NONE=y
BR2_ROOTFS_DEVICE_CREATION_STATIC=y
BR2_ROOTFS_DEVICE_TABLE=""
BR2_ROOTFS_STATIC_DEVICE_TABLE=""
BR2_ROOTFS_POST_BUILD_SCRIPT="board/laird/msd-x86/post_build.sh"
BR2_ROOTFS_POST_IMAGE_SCRIPT="board/laird/msd-x86/post_image.sh"
# BR2_PACKAGE_BUSYBOX is not set
BR2_PACKAGE_OPENSSL=y
BR2_PACKAGE_LIBEDIT=y
BR2_PACKAGE_CRDA=y
BR2_TARGET_ROOTFS_TAR_BZIP2=y
BR2_LRD_PLATFORM_WB50N=y
BR2_PACKAGE_EVENTMON=y
BR2_PACKAGE_LRD_LEGACY=y
BR2_PACKAGE_SDCSDK=y
BR2_PACKAGE_SDCCLI=y
BR2_PACKAGE_SDCSUPP=y
BR2_PACKAGE_WEB_LCM=y
BR2_PACKAGE_LAIRD_FIRMWARE=y
BR2_PACKAGE_LAIRD_FIRMWARE_AR6003=y
BR2_PACKAGE_LAIRD_FIRMWARE_AR6004=y
```

## configs/msd45n-x86_defconfig
```kconfig
BR2_WGET="wget --passive-ftp -nd"
BR2_DL_DIR="$(TOPDIR)/../archive"
BR2_JLEVEL=16
BR2_TOOLCHAIN_EXTERNAL=y
BR2_TOOLCHAIN_EXTERNAL_CUSTOM=y
BR2_TOOLCHAIN_EXTERNAL_PATH=""
BR2_TOOLCHAIN_EXTERNAL_CUSTOM_PREFIX="i586-laird-linux-gnu"
BR2_TOOLCHAIN_EXTERNAL_HEADERS_3_0=y
BR2_TOOLCHAIN_EXTERNAL_CUSTOM_GLIBC=y
BR2_TOOLCHAIN_EXTERNAL_CXX=y
BR2_TARGET_GENERIC_HOSTNAME=""
BR2_TARGET_GENERIC_ISSUE=""
BR2_INIT_NONE=y
BR2_ROOTFS_DEVICE_TABLE=""
BR2_ROOTFS_SKELETON_CUSTOM=y
BR2_ROOTFS_SKELETON_CUSTOM_PATH="$(TOPDIR)/board/laird/skeleton-empty"
BR2_ROOTFS_POST_BUILD_SCRIPT="board/laird/msd45n-x86/post_build.sh"
BR2_ROOTFS_POST_IMAGE_SCRIPT="board/laird/msd45n-x86/post_image.sh"
# BR2_PACKAGE_BUSYBOX is not set
BR2_PACKAGE_CRDA=y
BR2_TARGET_ROOTFS_TAR_BZIP2=y
BR2_LRD_PLATFORM_WB45N=y
BR2_PACKAGE_OPENSSL_FIPS=y
BR2_PACKAGE_EVENTMON=y
BR2_PACKAGE_SDCSDK=y
BR2_PACKAGE_SDCCLI=y
BR2_PACKAGE_SDCSUPP=y
BR2_PACKAGE_SDC2U=y
BR2_PACKAGE_WEB_LCM=y
```

## configs/msd50n_defconfig
```kconfig
BR2_arm=y
BR2_WGET="wget --passive-ftp -nd"
BR2_DL_DIR="$(TOPDIR)/../archive"
BR2_JLEVEL=16
BR2_TOOLCHAIN_EXTERNAL=y
BR2_TOOLCHAIN_EXTERNAL_CUSTOM=y
BR2_TOOLCHAIN_EXTERNAL_PATH=""
BR2_TOOLCHAIN_EXTERNAL_CUSTOM_PREFIX="arm-laird-linux-gnueabi"
BR2_TOOLCHAIN_EXTERNAL_HEADERS_3_15=y
BR2_TOOLCHAIN_EXTERNAL_CUSTOM_GLIBC=y
# BR2_TOOLCHAIN_EXTERNAL_INET_RPC is not set
BR2_TOOLCHAIN_EXTERNAL_CXX=y
BR2_TARGET_GENERIC_HOSTNAME=""
BR2_TARGET_GENERIC_ISSUE=""
BR2_INIT_NONE=y
BR2_ROOTFS_DEVICE_TABLE=""
BR2_ROOTFS_SKELETON_CUSTOM=y
BR2_ROOTFS_SKELETON_CUSTOM_PATH="$(TOPDIR)/board/laird/skeleton-empty"
BR2_ROOTFS_POST_BUILD_SCRIPT="board/laird/msd50n/post_build.sh"
BR2_ROOTFS_POST_IMAGE_SCRIPT="board/laird/msd50n/post_image.sh"
# BR2_PACKAGE_BUSYBOX is not set
BR2_PACKAGE_LIBEDIT=y
BR2_PACKAGE_CRDA=y
BR2_TARGET_ROOTFS_TAR_BZIP2=y
BR2_PACKAGE_OPENSSL_FIPS=y
BR2_PACKAGE_EVENTMON=y
BR2_PACKAGE_SDCSDK=y
BR2_PACKAGE_SDCCLI=y
BR2_PACKAGE_SDCSUPP=y
BR2_PACKAGE_SDC2U=y
BR2_PACKAGE_WEB_LCM=y
BR2_PACKAGE_LAIRD_FIRMWARE=y
BR2_PACKAGE_LAIRD_FIRMWARE_AR6003=y
BR2_PACKAGE_LAIRD_FIRMWARE_AR6004=y
BR2_PACKAGE_LAIRD_FIRMWARE_BT=y
```

## configs/reg50n-arm-eabi_defconfig
```kconfig
BR2_arm=y
BR2_WGET="wget --passive-ftp -nd"
BR2_DL_DIR="$(HOME)/.br2_dl_dir"
BR2_JLEVEL=16
BR2_CCACHE=y
BR2_CCACHE_DIR="$(BR2_DL_DIR)/.buildroot-ccache"
BR2_TOOLCHAIN_EXTERNAL=y
BR2_TOOLCHAIN_EXTERNAL_CUSTOM=y
BR2_TOOLCHAIN_EXTERNAL_CUSTOM_PREFIX="arm-laird-linux-gnueabi"
BR2_TOOLCHAIN_EXTERNAL_GCC_4_8=y
BR2_TOOLCHAIN_EXTERNAL_HEADERS_3_15=y
BR2_TOOLCHAIN_EXTERNAL_CUSTOM_GLIBC=y
# BR2_TOOLCHAIN_EXTERNAL_INET_RPC is not set
BR2_TOOLCHAIN_EXTERNAL_CXX=y
BR2_ROOTFS_SKELETON_CUSTOM=y
BR2_ROOTFS_SKELETON_CUSTOM_PATH="$(TOPDIR)/board/laird/skeleton-empty"
BR2_INIT_NONE=y
BR2_ROOTFS_DEVICE_TABLE=""
BR2_ROOTFS_POST_BUILD_SCRIPT="board/laird/mfg-reg/post_build.sh"
BR2_ROOTFS_POST_IMAGE_SCRIPT="board/laird/mfg-reg/post_image.sh"
# BR2_PACKAGE_BUSYBOX is not set
BR2_PACKAGE_OPENSSL=y
# BR2_TARGET_ROOTFS_TAR is not set
BR2_PACKAGE_SDCSDK=y
BR2_PACKAGE_SDCCLI=y
BR2_PACKAGE_SDCCLI_SMU_CLI=y
BR2_PACKAGE_AR6KL_TOOLS=y
BR2_PACKAGE_AR6KL_TOOLS_6004_SUPPORT=y
BR2_PACKAGE_LAIRD_FIRMWARE=y
BR2_PACKAGE_LAIRD_FIRMWARE_AR6004_MFG=y
BR2_PACKAGE_LRU_ATH6KL=y
BR2_PACKAGE_LRU_ATH6KL_WB50N_SUPPORT=y
```

## configs/reg50n-arm-eabihf_defconfig
```kconfig
BR2_arm=y
BR2_cortex_a5=y
BR2_ARM_ENABLE_VFP=y
BR2_ARM_FPU_VFPV2=y
BR2_WGET="wget --passive-ftp -nd"
BR2_DL_DIR="$(HOME)/.br2_dl_dir"
BR2_CCACHE=y
BR2_CCACHE_DIR="$(BR2_DL_DIR)/.buildroot-ccache"
BR2_TOOLCHAIN_EXTERNAL=y
BR2_TOOLCHAIN_EXTERNAL_LAIRD_COMPONENT=y
BR2_ROOTFS_SKELETON_CUSTOM=y
BR2_ROOTFS_SKELETON_CUSTOM_PATH="$(TOPDIR)/board/laird/skeleton-empty"
BR2_INIT_NONE=y
BR2_ROOTFS_DEVICE_TABLE=""
BR2_ROOTFS_POST_BUILD_SCRIPT="board/laird/mfg-reg/post_build.sh"
BR2_ROOTFS_POST_IMAGE_SCRIPT="board/laird/mfg-reg/post_image.sh"
BR2_ROOTFS_POST_SCRIPT_ARGS="reg50n-arm-eabihf"
# BR2_PACKAGE_BUSYBOX is not set
BR2_PACKAGE_OPENSSL=y
BR2_PACKAGE_READLINE=y
# BR2_TARGET_ROOTFS_TAR is not set
BR2_PACKAGE_SDCSDK=y
BR2_PACKAGE_SDCCLI=y
BR2_PACKAGE_SDCCLI_SMU_CLI=y
BR2_PACKAGE_AR6KL_TOOLS=y
BR2_PACKAGE_AR6KL_TOOLS_6004_SUPPORT=y
BR2_PACKAGE_LAIRD_FIRMWARE=y
BR2_PACKAGE_LAIRD_FIRMWARE_AR6004_MFG=y
BR2_PACKAGE_LRU_ATH6KL=y
BR2_PACKAGE_LRU_ATH6KL_WB50N_SUPPORT=y
```

## configs/regCypress-arm-eabihf_defconfig
```kconfig
BR2_arm=y
BR2_cortex_a5=y
BR2_ARM_ENABLE_VFP=y
BR2_ARM_FPU_VFPV2=y
BR2_WGET="wget --passive-ftp -nd"
BR2_DL_DIR="$(HOME)/.br2_dl_dir"
BR2_CCACHE=y
BR2_CCACHE_DIR="$(BR2_DL_DIR)/.buildroot-ccache"
BR2_TOOLCHAIN_EXTERNAL=y
BR2_TOOLCHAIN_EXTERNAL_CUSTOM=y
BR2_TOOLCHAIN_EXTERNAL_CUSTOM_PREFIX="arm-buildroot-linux-gnueabihf"
BR2_TOOLCHAIN_EXTERNAL_GCC_6=y
BR2_TOOLCHAIN_EXTERNAL_HEADERS_4_1=y
BR2_TOOLCHAIN_EXTERNAL_CUSTOM_GLIBC=y
BR2_TOOLCHAIN_EXTERNAL_CXX=y
BR2_ROOTFS_SKELETON_CUSTOM=y
BR2_ROOTFS_SKELETON_CUSTOM_PATH="$(TOPDIR)/board/laird/skeleton-empty"
BR2_INIT_NONE=y
BR2_ROOTFS_DEVICE_TABLE=""
BR2_ROOTFS_POST_BUILD_SCRIPT="board/laird/mfg-reg/post_build.sh"
BR2_ROOTFS_POST_IMAGE_SCRIPT="board/laird/mfg-reg/post_image.sh"
# BR2_PACKAGE_BUSYBOX is not set
# BR2_TARGET_ROOTFS_TAR is not set
BR2_PACKAGE_LAIRD_FIRMWARE=y
BR2_PACKAGE_LAIRD_FIRMWARE_BCM4343_MFG=y
BR2_PACKAGE_LAIRD_FIRMWARE_BCM4339_MFG=y
BR2_PACKAGE_LAIRD_FIRMWARE_BCM4373_MFG=y
BR2_PACKAGE_WL_FMAC=y
```

## configs/reglwb_defconfig
```kconfig
BR2_arm=y
BR2_WGET="wget --passive-ftp -nd"
BR2_DL_DIR="$(TOPDIR)/../archive"
BR2_JLEVEL=16
BR2_TOOLCHAIN_EXTERNAL=y
BR2_TOOLCHAIN_EXTERNAL_CUSTOM=y
BR2_TOOLCHAIN_EXTERNAL_PATH=""
BR2_TOOLCHAIN_EXTERNAL_CUSTOM_PREFIX="arm-sdc-linux-gnueabi"
BR2_TOOLCHAIN_EXTERNAL_GCC_4_5=y
BR2_TOOLCHAIN_EXTERNAL_HEADERS_3_0=y
BR2_TOOLCHAIN_EXTERNAL_CUSTOM_GLIBC=y
BR2_TOOLCHAIN_EXTERNAL_CXX=y
BR2_ROOTFS_SKELETON_CUSTOM=y
BR2_ROOTFS_SKELETON_CUSTOM_PATH="$(TOPDIR)/board/laird/skeleton-empty"
BR2_INIT_NONE=y
BR2_ROOTFS_DEVICE_TABLE=""
BR2_ROOTFS_POST_BUILD_SCRIPT="board/laird/reglwb/post_build.sh"
BR2_ROOTFS_POST_IMAGE_SCRIPT="board/laird/reglwb/post_image.sh"
# BR2_PACKAGE_BUSYBOX is not set
# BR2_TARGET_ROOTFS_TAR is not set
BR2_PACKAGE_WL_FMAC=y
```

## configs/som60_defconfig
```kconfig
BR2_arm=y
BR2_cortex_a5=y
BR2_ARM_ENABLE_VFP=y
BR2_ARM_INSTRUCTIONS_THUMB2=y
BR2_WGET="wget --passive-ftp -nd"
BR2_DL_DIR="$(TOPDIR)/../archive"
BR2_JLEVEL=16
BR2_OPTIMIZE_3=y
BR2_PACKAGE_OVERRIDE_FILE="$(TOPDIR)/board/laird/som60/som60-local.mk"
BR2_TOOLCHAIN_EXTERNAL=y
BR2_TOOLCHAIN_EXTERNAL_CUSTOM=y
BR2_TOOLCHAIN_EXTERNAL_CUSTOM_PREFIX="arm-buildroot-linux-gnueabihf"
BR2_TOOLCHAIN_EXTERNAL_GCC_6=y
BR2_TOOLCHAIN_EXTERNAL_HEADERS_4_1=y
BR2_TOOLCHAIN_EXTERNAL_CUSTOM_GLIBC=y
BR2_TOOLCHAIN_EXTERNAL_CXX=y
BR2_TARGET_GENERIC_HOSTNAME="summit"
BR2_TARGET_GENERIC_ISSUE="Laird"
BR2_ROOTFS_DEVICE_CREATION_DYNAMIC_EUDEV=y
BR2_ROOTFS_DEVICE_TABLE="board/laird/device_table.txt"
BR2_ENABLE_LOCALE_WHITELIST="en_US"
BR2_ROOTFS_POST_BUILD_SCRIPT="board/laird/som60/post_build.sh"
BR2_ROOTFS_POST_IMAGE_SCRIPT="board/laird/som60/post_image.sh"
BR2_LINUX_KERNEL=y
BR2_LINUX_KERNEL_DEFCONFIG="som60"
BR2_LINUX_KERNEL_DTS_SUPPORT=y
BR2_LINUX_KERNEL_INTREE_DTS_NAME="at91-dvk_som60"
BR2_PACKAGE_BUSYBOX_CONFIG="$(TOPDIR)/board/laird/configs-common/busybox.config"
BR2_PACKAGE_BUSYBOX_SHOW_OTHERS=y
BR2_PACKAGE_ALSA_UTILS=y
BR2_PACKAGE_ALSA_UTILS_APLAY=y
BR2_PACKAGE_ALSA_UTILS_SPEAKER_TEST=y
BR2_PACKAGE_BZIP2=y
BR2_PACKAGE_GDB=y
BR2_PACKAGE_LSOF=y
BR2_PACKAGE_NETPERF=y
BR2_PACKAGE_STRACE=y
BR2_PACKAGE_TRACE_CMD=y
BR2_PACKAGE_WHETSTONE=y
BR2_PACKAGE_MTD=y
BR2_PACKAGE_DEVMEM2=y
BR2_PACKAGE_I2C_TOOLS=y
BR2_PACKAGE_INPUT_EVENT_DAEMON=y
BR2_PACKAGE_LINUXCONSOLETOOLS=y
BR2_PACKAGE_MEMTESTER=y
BR2_PACKAGE_RNG_TOOLS=y
BR2_PACKAGE_SETSERIAL=y
BR2_PACKAGE_SREDIRD=y
BR2_PACKAGE_STATSERIAL=y
BR2_PACKAGE_UBOOT_TOOLS=y
BR2_PACKAGE_USBMOUNT=y
BR2_PACKAGE_LZO=y
BR2_PACKAGE_LIBSSH=y
BR2_PACKAGE_LIBOPENSSL_BIN=y
BR2_PACKAGE_DTC=y
BR2_PACKAGE_DTC_PROGRAMS=y
BR2_PACKAGE_LIBTIRPC=y
BR2_PACKAGE_LIBDAEMON=y
BR2_PACKAGE_LIBEDIT=y
BR2_PACKAGE_BLUEZ5_UTILS=y
BR2_PACKAGE_BLUEZ5_UTILS_OBEX=y
BR2_PACKAGE_BLUEZ5_UTILS_CLIENT=y
BR2_PACKAGE_BLUEZ5_UTILS_DEPRECATED=y
BR2_PACKAGE_BLUEZ5_UTILS_EXPERIMENTAL=y
BR2_PACKAGE_BLUEZ5_UTILS_TEST=y
BR2_PACKAGE_BRIDGE_UTILS=y
BR2_PACKAGE_CONNTRACK_TOOLS=y
BR2_PACKAGE_CRDA=y
BR2_PACKAGE_CRDA_NO_SIGN_CHECK=y
BR2_PACKAGE_DHCP=y
BR2_PACKAGE_DHCP_CLIENT=y
BR2_PACKAGE_DNSMASQ=y
BR2_PACKAGE_DNSMASQ_DNSSEC=y
BR2_PACKAGE_EBTABLES=y
BR2_PACKAGE_ETHTOOL=y
BR2_PACKAGE_IPERF=y
BR2_PACKAGE_IPROUTE2=y
BR2_PACKAGE_IPSEC_TOOLS=y
# BR2_PACKAGE_IPSEC_TOOLS_STATS is not set
BR2_PACKAGE_IPTABLES=y
BR2_PACKAGE_IW=y
BR2_PACKAGE_LRZSZ=y
BR2_PACKAGE_MII_DIAG=y
BR2_PACKAGE_NCFTP=y
# BR2_PACKAGE_NCFTP_GET is not set
# BR2_PACKAGE_NCFTP_PUT is not set
# BR2_PACKAGE_NCFTP_LS is not set
# BR2_PACKAGE_NCFTP_BATCH is not set
BR2_PACKAGE_NDISC6=y
BR2_PACKAGE_NDISC6_NAME2ADDR=y
BR2_PACKAGE_NDISC6_NDISC6=y
BR2_PACKAGE_NDISC6_RDISC6=y
BR2_PACKAGE_NDISC6_RDNSSD=y
BR2_PACKAGE_NDISC6_RLTRACEROUTE6=y
BR2_PACKAGE_NDISC6_TCPTRACEROUTE6=y
BR2_PACKAGE_NDISC6_TCPSPRAY=y
BR2_PACKAGE_NETCAT=y
BR2_PACKAGE_NETSTAT_NAT=y
BR2_PACKAGE_NTP=y
# BR2_PACKAGE_NTP_NTPD is not set
BR2_PACKAGE_NTP_NTPDATE=y
BR2_PACKAGE_OPENSSH=y
BR2_PACKAGE_PPPD=y
BR2_PACKAGE_RSYNC=y
BR2_PACKAGE_TCPDUMP=y
BR2_PACKAGE_WGET=y
BR2_PACKAGE_KMOD_TOOLS=y
BR2_PACKAGE_UTIL_LINUX_BINARIES=y
BR2_PACKAGE_UTIL_LINUX_HWCLOCK=y
BR2_TARGET_ROOTFS_SQUASHFS=y
BR2_TARGET_ROOTFS_SQUASHFS4_LZO=y
# BR2_TARGET_ROOTFS_TAR is not set
BR2_TARGET_UBOOT=y
BR2_TARGET_UBOOT_BUILD_SYSTEM_KCONFIG=y
BR2_TARGET_UBOOT_CUSTOM_VERSION=y
BR2_TARGET_UBOOT_CUSTOM_VERSION_VALUE="2018.01"
BR2_TARGET_UBOOT_BOARD_DEFCONFIG="som60"
BR2_TARGET_UBOOT_NEEDS_DTC=y
# BR2_TARGET_UBOOT_FORMAT_BIN is not set
BR2_TARGET_UBOOT_FORMAT_ITB=y
BR2_TARGET_UBOOT_SPL=y
BR2_TARGET_UBOOT_SPL_NAME="spl/u-boot-spl-nodtb.bin spl/u-boot-spl.dtb"
BR2_PACKAGE_HOST_CRYPTSETUP=y
BR2_PACKAGE_HOST_GENIMAGE=y
BR2_PACKAGE_HOST_UBOOT_TOOLS=y
BR2_PACKAGE_HOST_UBOOT_TOOLS_FIT_SUPPORT=y
BR2_PACKAGE_HOST_UBOOT_TOOLS_FIT_SIGNATURE_SUPPORT=y
BR2_PACKAGE_OPENSSL_FIPS=y
BR2_PACKAGE_MC_MINT=y
BR2_PACKAGE_LRD_NETWORK_MANAGER=y
BR2_PACKAGE_SDCSUPP=y
BR2_PACKAGE_LAIRD_FIRMWARE=y
BR2_PACKAGE_LAIRD_FIRMWARE_LRDMWL_SD8997=y
```

## configs/som60x2sd-wbx3_defconfig
```kconfig
BR2_arm=y
BR2_cortex_a5=y
BR2_ARM_ENABLE_VFP=y
BR2_WGET="wget --passive-ftp -nd"
BR2_DL_DIR="$(HOME)/.br2_dl_dir"
BR2_CCACHE=y
BR2_CCACHE_DIR="$(BR2_DL_DIR)/.buildroot-ccache"
BR2_OPTIMIZE_3=y
BR2_PACKAGE_OVERRIDE_FILE="$(TOPDIR)/board/laird/som60/som60-local.mk"
BR2_TOOLCHAIN_EXTERNAL=y
BR2_TOOLCHAIN_EXTERNAL_LAIRD_ARM=y
BR2_TARGET_GENERIC_HOSTNAME="summit"
BR2_TARGET_GENERIC_ISSUE="Laird Connectivity"
BR2_INIT_NONE=y
BR2_ROOTFS_DEVICE_TABLE=""
# BR2_TARGET_ENABLE_ROOT_LOGIN is not set
BR2_SYSTEM_BIN_SH_NONE=y
# BR2_TARGET_GENERIC_GETTY is not set
# BR2_TARGET_GENERIC_REMOUNT_ROOTFS_RW is not set
# BR2_ENABLE_LOCALE_PURGE is not set
BR2_ROOTFS_POST_IMAGE_SCRIPT="board/laird/wbx3/post_image.sh"
# BR2_PACKAGE_BUSYBOX is not set
# BR2_PACKAGE_IFUPDOWN_SCRIPTS is not set
# BR2_TARGET_ROOTFS_TAR is not set
BR2_TARGET_UBOOT=y
BR2_TARGET_UBOOT_BUILD_SYSTEM_KCONFIG=y
BR2_TARGET_UBOOT_CUSTOM_VERSION=y
BR2_TARGET_UBOOT_CUSTOM_VERSION_VALUE="2018.01"
BR2_TARGET_UBOOT_BOARD_DEFCONFIG="som60x2sd-wbx3"
BR2_TARGET_UBOOT_NEEDS_DTC=y
# BR2_TARGET_UBOOT_FORMAT_BIN is not set
BR2_TARGET_UBOOT_FORMAT_ITB=y
BR2_TARGET_UBOOT_SPL=y
BR2_TARGET_UBOOT_SPL_NAME="spl/u-boot-spl-nodtb.bin spl/u-boot-spl.dtb"
BR2_PACKAGE_HOST_CRYPTSETUP=y
BR2_PACKAGE_HOST_MTD=y
BR2_PACKAGE_HOST_UBOOT_TOOLS=y
BR2_PACKAGE_HOST_UBOOT_TOOLS_FIT_SUPPORT=y
BR2_PACKAGE_HOST_UBOOT_TOOLS_FIT_SIGNATURE_SUPPORT=y
```
