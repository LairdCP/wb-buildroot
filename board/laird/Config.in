## board/laird/Config.in
```kconfig
menu "Laird Connectivity"

	config BR2_LRD_DEVEL_BUILD
	bool
	option env="BR2_LRD_DEVEL_BUILD"
	help
	  Developers at Laird can access the closed source repositories,
	  so they should set this flag to directly build from the closed
	  source repositories under package/lrd-closed-source/externals.

	config BR2_SUMMIT_SECURE_BOOT
	bool "Summit Secure Boot"
	select BR2_TARGET_UBOOT_NEEDS_OPENSSL
	help
	  This enables "traditional" (down to kernel) secure boot
	  rootfs security provided by BR2_PACKAGE_LRD_ENCRYPTED_STORAGE_TOOLKIT

	menu "Radio Stack"
		source "package/lrd/lrd-radio/Config.in"
	endmenu

	menu "Packages"
		source "package/lrd/Config.in"
	endmenu

	menu "Packages (Closed Source)"
		source "package/lrd-closed-source/Config.in"
	endmenu

endmenu
```

## board/laird/configs-common/image/u-boot-enc.its
```
/*
 * Copyright (C) 2018-2020 Laird Connectivity
 *
 * Minimal dts for a SPL FIT image payload.
 *
 * SPDX-License-Identifier: GPL-2.0+  X11
 */

/dts-v1/;

/ {
	description = "Summit U-Boot FIT Image";
	#address-cells = <1>;

	images {
		encryption = "aes128";
		uboot {
			description = "Summit U-Boot";
			data = /incbin/("u-boot-nodtb.bin.enc");
			type = "standalone";
			os = "U-Boot";
			arch = "arm";
			compression = "none";
			load = <0x21000000>;

			hash {
				algo = "sha256";
			};
		};

		fdt {
			description = "Flattened Device Tree blob";
			data = /incbin/("u-boot.dtb.enc");
			type = "flat_dt";
			arch = "arm";
			compression = "none";

			hash {
				algo = "sha256";
			};
		};

		script {
			description = "Boot script";
			data = /incbin/("u-boot.scr.itb.enc");
			type = "script";
			load = <0x20100000>;
			compression = "none";

			hash {
				algo = "sha256";
			};
		};
	};

	configurations {
		default = "config";

		config {
			description = "Summit U-Boot with FDT blob";
			loadables = "uboot", "script";
			fdt = "fdt";

			signature {
				algo = "sha256,rsa2048";
				key-name-hint = "dev";
				sign-images = "loadables", "fdt";
			};
		};
	};
};
```

## board/laird/som60/configs/kernel.its
```
/dts-v1/;

/ {
	description = "Summit FIT Image";
	#address-cells = <1>;

	images {
		kernel@1 {
			description = "Summit Linux Kernel";
			data = /incbin/("Image.gz");
			type = "kernel";
			arch = "arm";
			os = "linux";
			compression = "gzip";
			load = <0x20008000>;
			entry = <0x20008000>;
			kernel-version = <1>;
			hash@1 {
				algo = "sha256";
			};
		};

		fdt@1 {
			description = "Flattened Device Tree blob";
			data = /incbin/("at91-dvk_som60.dtb");
			type = "flat_dt";
			arch = "arm";
			compression = "none";
			fdt-version = <1>;
			hash@1 {
				algo = "sha256";
			};
		};

		script@1 {
			description = "Boot script";
			data = /incbin/("boot.scr");
			type = "script";
			arch = "arm";
			compression = "none";
			hash@1 {
				algo = "sha256";
			};
		};
	};

	configurations {
		default = "config@1";
		config@1 {
			description = "Summit Linux kernel with FDT blob";
			kernel = "kernel@1";
			fdt = "fdt@1";
			loadables = "script@1";
			signature@1 {
				algo = "sha256,rsa2048";
				key-name-hint = "dev";
				sign-images = "loadables", "fdt", "kernel";
			};
		};
	};
};
```

## board/laird/som60/configs/u-boot.its
```
/*
 * Copyright (C) 2018 Laird
 *
 * Minimal dts for a SPL FIT image payload.
 *
 * SPDX-License-Identifier: GPL-2.0+  X11
 */

/dts-v1/;

/ {
	description = "FIT image with U-Boot, DTB";
	#address-cells = <1>;

	images {
		uboot {
			description = "U-Boot";
			data = /incbin/("u-boot-nodtb.bin");
			type = "firmware";
			os = "U-Boot";
			arch = "arm";
			compression = "none";
			load = <0x23f00000>;
			firmware-version = <1>;
			hash {
				algo = "sha256";
			};
		};
		fdt {
			description = "SOM60 flat device-tree";
			data = /incbin/("u-boot.dtb");
			type = "flat_dt";
			compression = "none";
			fdt-version = <1>;
			hash {
				algo = "sha256";
			};
		};
	};

	configurations {
		default = "conf";
		conf {
			description = "Laird SOM60";
			firmware = "uboot";
			fdt = "fdt";
			signature {
				algo = "sha256,rsa2048";
				key-name-hint = "dev";
				sign-images = "fdt", "firmware";
			};
		};
	};
};
```

## board/laird/som60sd_mfg/configs/kernel.its
```
/dts-v1/;

/ {
	description = "Laird OS kernel image & FDT blob";
	#address-cells = <1>;

	images {
		kernel@1 {
			data = /incbin/("zImage");
			type = "kernel";
			arch = "arm";
			os = "linux";
			compression = "none";
			load = <0x22000000>;
			entry = <0x22000000>;
			kernel-version = <1>;
			hash@1 {
				algo = "sha256";
			};
		};
		fdt@1 {
			data = /incbin/("at91-dvk_som60sd_mfg.dtb");
			type = "flat_dt";
			arch = "arm";
			compression = "none";
			fdt-version = <1>;
			hash@1 {
				algo = "sha256";
			};
		};
		script@1 {
			data = /incbin/("boot.scr");
			type = "script";
			arch = "arm";
			compression = "none";
			hash@1 {
				algo = "sha256";
			};
		};
	};
	configurations {
		default = "config@1";
		config@1 {
			kernel = "kernel@1";
			fdt = "fdt@1";
			loadables = "script@1";
			signature@1 {
				algo = "sha256,rsa2048";
				key-name-hint = "dev";
				sign-images = "loadables", "fdt", "kernel";
			};
		};
	};
};
```

## configs/adaptive_ww_openssl_1_0_2-arm-eabi_defconfig
```kconfig
BR2_arm=y
BR2_WGET="wget --passive-ftp -nd"
BR2_DL_DIR="$(HOME)/.br2_dl_dir"
BR2_CCACHE=y
BR2_CCACHE_DIR="$(BR2_DL_DIR)/.buildroot-ccache"
BR2_TOOLCHAIN_EXTERNAL=y
BR2_TOOLCHAIN_EXTERNAL_CUSTOM=y
BR2_TOOLCHAIN_EXTERNAL_CUSTOM_PREFIX="arm-sdc-linux-gnueabi"
BR2_TOOLCHAIN_EXTERNAL_GCC_4_5=y
BR2_TOOLCHAIN_EXTERNAL_HEADERS_3_0=y
BR2_TOOLCHAIN_EXTERNAL_CUSTOM_GLIBC=y
BR2_TOOLCHAIN_EXTERNAL_CXX=y
BR2_ROOTFS_SKELETON_CUSTOM=y
BR2_ROOTFS_SKELETON_CUSTOM_PATH="$(TOPDIR)/board/laird/skeleton-empty"
BR2_INIT_NONE=y
BR2_ROOTFS_DEVICE_TABLE=""
BR2_ROOTFS_POST_IMAGE_SCRIPT="board/laird/adaptive_ww/post_image.sh"
# BR2_PACKAGE_BUSYBOX is not set
BR2_PACKAGE_OPENSSL=y
BR2_PACKAGE_LIBOPENSSL_1_0_2=y
# BR2_TARGET_ROOTFS_TAR is not set
BR2_PACKAGE_ADAPTIVE_WW=y
BR2_PACKAGE_ADAPTVE_WW_REGPWRDB=y
```

## configs/adaptive_ww_openssl_1_0_2-x86_defconfig
```kconfig
BR2_WGET="wget --passive-ftp -nd"
BR2_DL_DIR="$(HOME)/.br2_dl_dir"
BR2_CCACHE=y
BR2_CCACHE_DIR="$(BR2_DL_DIR)/.buildroot-ccache"
BR2_TOOLCHAIN_EXTERNAL=y
BR2_TOOLCHAIN_EXTERNAL_LAIRD_COMPONENT=y
BR2_ROOTFS_SKELETON_CUSTOM=y
BR2_ROOTFS_SKELETON_CUSTOM_PATH="$(TOPDIR)/board/laird/skeleton-empty"
BR2_INIT_NONE=y
BR2_ROOTFS_DEVICE_TABLE=""
BR2_ROOTFS_POST_IMAGE_SCRIPT="board/laird/adaptive_ww/post_image.sh"
# BR2_PACKAGE_BUSYBOX is not set
BR2_PACKAGE_OPENSSL=y
BR2_PACKAGE_LIBOPENSSL_1_0_2=y
# BR2_TARGET_ROOTFS_TAR is not set
BR2_PACKAGE_ADAPTIVE_WW=y
BR2_PACKAGE_ADAPTVE_WW_REGPWRDB=y
```

## configs/backports-test_defconfig
```kconfig
BR2_arm=y
BR2_WGET="wget --passive-ftp -nd"
BR2_DL_DIR="$(HOME)/.br2_dl_dir"
BR2_CCACHE=y
BR2_CCACHE_DIR="$(BR2_DL_DIR)/.buildroot-ccache"
BR2_TOOLCHAIN_EXTERNAL=y
BR2_TOOLCHAIN_EXTERNAL_LAIRD_ARM=y
BR2_ROOTFS_SKELETON_CUSTOM=y
BR2_ROOTFS_SKELETON_CUSTOM_PATH="$(TOPDIR)/board/laird/skeleton-empty"
BR2_INIT_NONE=y
BR2_ROOTFS_POST_IMAGE_SCRIPT="board/laird/backports/post_image_test.sh"
# BR2_PACKAGE_BUSYBOX is not set
# BR2_TARGET_ROOTFS_TAR is not set
BR2_PACKAGE_HOST_BACKPORTS_TEST=y
```
