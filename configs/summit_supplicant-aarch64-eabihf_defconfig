## configs/summit_supplicant-aarch64-eabihf_defconfig
```kconfig
BR2_aarch64=y
BR2_ARM_FPU_VFPV4D16=y
BR2_WGET="wget --passive-ftp -nd"
BR2_DL_DIR="$(HOME)/.br2_dl_dir"
BR2_JLEVEL=16
BR2_CCACHE=y
BR2_CCACHE_DIR="$(BR2_DL_DIR)/.buildroot-ccache"
BR2_TOOLCHAIN_EXTERNAL=y
BR2_TOOLCHAIN_EXTERNAL_CUSTOM=y
BR2_TOOLCHAIN_EXTERNAL_CUSTOM_PREFIX="aarch64-buildroot-linux-gnu"
BR2_TOOLCHAIN_EXTERNAL_GCC_5=y
BR2_TOOLCHAIN_EXTERNAL_HEADERS_3_10=y
BR2_TOOLCHAIN_EXTERNAL_CUSTOM_GLIBC=y
BR2_TOOLCHAIN_EXTERNAL_CXX=y
BR2_ROOTFS_SKELETON_CUSTOM=y
BR2_ROOTFS_SKELETON_CUSTOM_PATH="$(TOPDIR)/board/laird/skeleton-empty"
BR2_INIT_NONE=y
BR2_ROOTFS_DEVICE_TABLE=""
BR2_ROOTFS_POST_IMAGE_SCRIPT="board/laird/supplicant/post_image.sh"
# BR2_PACKAGE_BUSYBOX is not set
BR2_PACKAGE_DBUS=y
BR2_PACKAGE_OPENSSL=y
# BR2_TARGET_ROOTFS_TAR is not set
BR2_PACKAGE_SDCSUPP=y
BR2_PACKAGE_SDCSUPP_WPA_CLI=y
```

## configs/summit_supplicant-arm-eabi_defconfig
```kconfig
BR2_arm=y
BR2_WGET="wget --passive-ftp -nd"
BR2_DL_DIR="$(HOME)/.br2_dl_dir"
BR2_CCACHE=y
BR2_CCACHE_DIR="$(BR2_DL_DIR)/.buildroot-ccache"
BR2_TOOLCHAIN_EXTERNAL=y
BR2_TOOLCHAIN_EXTERNAL_CUSTOM=y
BR2_TOOLCHAIN_EXTERNAL_CUSTOM_PREFIX="arm-sdc-linux-gnueabi"
BR2_TOOLCHAIN_EXTERNAL_GCC_4_5=y
BR2_TOOLCHAIN_EXTERNAL_HEADERS_3_0=y
BR2_TOOLCHAIN_EXTERNAL_CUSTOM_GLIBC=y
BR2_TOOLCHAIN_EXTERNAL_CXX=y
BR2_ROOTFS_SKELETON_CUSTOM=y
BR2_ROOTFS_SKELETON_CUSTOM_PATH="$(TOPDIR)/board/laird/skeleton-empty"
BR2_INIT_NONE=y
BR2_ROOTFS_DEVICE_TABLE=""
BR2_ROOTFS_POST_IMAGE_SCRIPT="board/laird/supplicant/post_image.sh"
# BR2_PACKAGE_BUSYBOX is not set
BR2_PACKAGE_DBUS=y
BR2_PACKAGE_OPENSSL=y
# BR2_TARGET_ROOTFS_TAR is not set
BR2_PACKAGE_SDCSUPP=y
BR2_PACKAGE_SDCSUPP_WPA_CLI=y
BR2_PACKAGE_SDCSUPP_WPA_PASSPHRASE=y
```

## configs/summit_supplicant_legacy-arm-eabi_defconfig
```kconfig
BR2_arm=y
BR2_WGET="wget --passive-ftp -nd"
BR2_DL_DIR="$(HOME)/.br2_dl_dir"
BR2_JLEVEL=16
BR2_CCACHE=y
BR2_CCACHE_DIR="$(BR2_DL_DIR)/.buildroot-ccache"
BR2_TOOLCHAIN_EXTERNAL=y
BR2_TOOLCHAIN_EXTERNAL_CUSTOM=y
BR2_TOOLCHAIN_EXTERNAL_CUSTOM_PREFIX="arm-laird-linux-gnueabi"
BR2_TOOLCHAIN_EXTERNAL_GCC_4_8=y
BR2_TOOLCHAIN_EXTERNAL_HEADERS_3_15=y
BR2_TOOLCHAIN_EXTERNAL_CUSTOM_GLIBC=y
# BR2_TOOLCHAIN_EXTERNAL_INET_RPC is not set
BR2_ROOTFS_SKELETON_CUSTOM=y
BR2_ROOTFS_SKELETON_CUSTOM_PATH="$(TOPDIR)/board/laird/skeleton-empty"
BR2_INIT_NONE=y
BR2_ROOTFS_DEVICE_TABLE=""
BR2_ROOTFS_POST_IMAGE_SCRIPT="board/laird/supplicant/post_image.sh"
# BR2_PACKAGE_BUSYBOX is not set
BR2_PACKAGE_OPENSSL=y
BR2_PACKAGE_LIBOPENSSL_1_0_2=y
# BR2_TARGET_ROOTFS_TAR is not set
BR2_PACKAGE_SDCSDK=y
BR2_PACKAGE_SDCCLI=y
BR2_PACKAGE_SDCSUPP=y
BR2_PACKAGE_SDCSUPP_LEGACY=y
```

## configs/wb40n_rdvk_3_2_defconfig
```kconfig
BR2_arm=y
BR2_WGET="wget --passive-ftp -nd"
BR2_DL_DIR="$(HOME)/.br2_dl_dir"
BR2_CCACHE=y
BR2_CCACHE_DIR="$(BR2_DL_DIR)/.buildroot-ccache"
BR2_OPTIMIZE_3=y
BR2_PACKAGE_OVERRIDE_FILE="$(TOPDIR)/board/laird/wb40n_rdvk/wb40n_3_2_devel-local.mk"
BR2_TOOLCHAIN_BUILDROOT_GLIBC=y
BR2_PACKAGE_HOST_LINUX_HEADERS_CUSTOM_3_2=y
BR2_GCC_VERSION_5_X=y
BR2_TOOLCHAIN_BUILDROOT_CXX=y
BR2_TARGET_GENERIC_HOSTNAME="summit"
BR2_TARGET_GENERIC_ISSUE="Laird Connectivity"
BR2_ROOTFS_DEVICE_CREATION_DYNAMIC_EUDEV=y
BR2_ROOTFS_DEVICE_TABLE="board/laird/device_table.txt"
BR2_ROOTFS_MERGED_USR=y
BR2_TARGET_GENERIC_ROOT_PASSWD="summit"
BR2_ENABLE_LOCALE_WHITELIST="en_US"
BR2_ROOTFS_POST_BUILD_SCRIPT="board/laird/wb40n_rdvk/post_build_3_2.sh"
BR2_ROOTFS_POST_IMAGE_SCRIPT="board/laird/wb40n_rdvk/post_image.sh"
BR2_LINUX_KERNEL=y
BR2_LINUX_KERNEL_CUSTOM_VERSION=y
BR2_LINUX_KERNEL_CUSTOM_VERSION_VALUE="3.2.102"
BR2_LINUX_KERNEL_PATCH="$(TOPDIR)/board/laird/wb40n_rdvk/patches/linux"
BR2_LINUX_KERNEL_USE_CUSTOM_CONFIG=y
BR2_LINUX_KERNEL_CUSTOM_CONFIG_FILE="$(TOPDIR)/board/laird/wb40n_rdvk/patches/linux/wb40n_defconfig"
BR2_LINUX_KERNEL_UIMAGE=y
BR2_LINUX_KERNEL_LZMA=y
BR2_LINUX_KERNEL_UIMAGE_LOADADDR="0x21000000"
BR2_PACKAGE_BUSYBOX_CONFIG="$(TOPDIR)/board/laird/configs-common/busybox.config"
BR2_PACKAGE_BUSYBOX_SHOW_OTHERS=y
BR2_PACKAGE_BZIP2=y
BR2_PACKAGE_LSOF=y
BR2_PACKAGE_MTD=y
BR2_PACKAGE_DEVMEM2=y
BR2_PACKAGE_I2C_TOOLS=y
BR2_PACKAGE_LINUX_BACKPORTS=y
BR2_PACKAGE_LINUX_BACKPORTS_DEFCONFIG="bdimx6"
BR2_PACKAGE_MEMTESTER=y
BR2_PACKAGE_SETSERIAL=y
BR2_PACKAGE_STATSERIAL=y
BR2_PACKAGE_UBOOT_TOOLS=y
BR2_PACKAGE_USBMOUNT=y
BR2_PACKAGE_USBUTILS=y
BR2_PACKAGE_LIBOPENSSL_BIN=y
BR2_PACKAGE_LIBTIRPC=y
BR2_PACKAGE_LIBEDIT=y
BR2_PACKAGE_BLUEZ_UTILS=y
BR2_PACKAGE_BRCM_PATCHRAM_PLUS=y
BR2_PACKAGE_DHCP=y
BR2_PACKAGE_DHCP_CLIENT=y
BR2_PACKAGE_BRIDGE_UTILS=y
BR2_PACKAGE_DNSMASQ=y
BR2_PACKAGE_DNSMASQ_DNSSEC=y
BR2_PACKAGE_DROPBEAR=y
BR2_PACKAGE_ETHTOOL=y
BR2_PACKAGE_IPERF=y
BR2_PACKAGE_IPROUTE2=y
BR2_PACKAGE_IPTABLES=y
BR2_PACKAGE_IW=y
BR2_PACKAGE_NETSTAT_NAT=y
BR2_PACKAGE_NETWORK_MANAGER=y
BR2_PACKAGE_PPPD=y
BR2_PACKAGE_RSYNC=y
BR2_PACKAGE_TCPDUMP=y
BR2_PACKAGE_WGET=y
BR2_PACKAGE_WIRELESS_REGDB=y
BR2_PACKAGE_WPA_SUPPLICANT=y
BR2_PACKAGE_WPA_SUPPLICANT_AP_SUPPORT=y
BR2_PACKAGE_WPA_SUPPLICANT_AUTOSCAN=y
BR2_PACKAGE_WPA_SUPPLICANT_EAP=y
BR2_PACKAGE_WPA_SUPPLICANT_DEBUG_SYSLOG=y
BR2_PACKAGE_WPA_SUPPLICANT_CLI=y
BR2_PACKAGE_WPA_SUPPLICANT_PASSPHRASE=y
BR2_PACKAGE_WPA_SUPPLICANT_DBUS=y
BR2_PACKAGE_WPA_SUPPLICANT_DBUS_INTROSPECTION=y
BR2_PACKAGE_KMOD_TOOLS=y
BR2_PACKAGE_UTIL_LINUX_BINARIES=y
BR2_PACKAGE_UTIL_LINUX_HWCLOCK=y
BR2_TARGET_ROOTFS_TAR_BZIP2=y
BR2_TARGET_ROOTFS_UBI=y
BR2_TARGET_ROOTFS_UBIFS_MAXLEBCNT=955
BR2_TARGET_ROOTFS_UBIFS_LZO=y
BR2_TARGET_AT91BOOTSTRAP3=y
BR2_TARGET_AT91BOOTSTRAP3_DEFCONFIG="wb40n_uboot"
BR2_TARGET_UBOOT=y
BR2_TARGET_UBOOT_BUILD_SYSTEM_LEGACY=y
BR2_TARGET_UBOOT_BOARDNAME="wb40n"
BR2_PACKAGE_LRD_WIRELESS_REGDB=y
BR2_PACKAGE_MC_MINT=y
BR2_PACKAGE_SDCSUPP=y
BR2_PACKAGE_LAIRD_FIRMWARE=y
BR2_PACKAGE_LAIRD_FIRMWARE_AR6004=y
BR2_PACKAGE_LAIRD_FIRMWARE_BCM4343=y
BR2_PACKAGE_LAIRD_FIRMWARE_BCM4339=y
BR2_PACKAGE_LAIRD_FIRMWARE_LRDMWL_ST60_SDIO_UART=y
BR2_PACKAGE_LAIRD_FIRMWARE_LRDMWL_ST60_SDIO_SDIO=y
BR2_PACKAGE_LAIRD_FIRMWARE_LRDMWL_ST60_USB_UART=y
BR2_PACKAGE_LAIRD_FIRMWARE_LRDMWL_ST60_USB_USB=y
BR2_PACKAGE_LAIRD_FIRMWARE_LRDMWL_SU60_SDIO_UART=y
BR2_PACKAGE_LAIRD_FIRMWARE_LRDMWL_SU60_SDIO_SDIO=y
BR2_PACKAGE_LAIRD_FIRMWARE_LRDMWL_SU60_USB_UART=y
BR2_PACKAGE_LAIRD_FIRMWARE_LRDMWL_SU60_USB_USB=y
BR2_PACKAGE_ADAPTIVE_WW=y
```

## configs/wb40n_rdvk_defconfig
```kconfig
BR2_arm=y
BR2_WGET="wget --passive-ftp -nd"
BR2_DL_DIR="$(HOME)/.br2_dl_dir"
BR2_CCACHE=y
BR2_CCACHE_DIR="$(BR2_DL_DIR)/.buildroot-ccache"
BR2_OPTIMIZE_3=y
BR2_PACKAGE_OVERRIDE_FILE="$(TOPDIR)/board/laird/wb40n_rdvk/wb40n_devel-local.mk"
BR2_TOOLCHAIN_BUILDROOT_GLIBC=y
BR2_PACKAGE_HOST_LINUX_HEADERS_CUSTOM_4_19=y
BR2_GCC_VERSION_5_X=y
BR2_TOOLCHAIN_BUILDROOT_CXX=y
BR2_TARGET_GENERIC_HOSTNAME="summit"
BR2_TARGET_GENERIC_ISSUE="Laird Connectivity"
BR2_ROOTFS_DEVICE_CREATION_DYNAMIC_EUDEV=y
BR2_ROOTFS_DEVICE_TABLE="board/laird/device_table.txt"
BR2_ROOTFS_MERGED_USR=y
BR2_TARGET_GENERIC_ROOT_PASSWD="summit"
BR2_ENABLE_LOCALE_WHITELIST="en_US"
BR2_ROOTFS_POST_BUILD_SCRIPT="board/laird/wb40n_rdvk/post_build.sh"
BR2_ROOTFS_POST_IMAGE_SCRIPT="board/laird/wb40n_rdvk/post_image.sh"
BR2_LINUX_KERNEL=y
BR2_LINUX_KERNEL_DEFCONFIG="wb40n_rdvk"
BR2_LINUX_KERNEL_APPENDED_UIMAGE=y
BR2_LINUX_KERNEL_LZMA=y
BR2_LINUX_KERNEL_UIMAGE_LOADADDR="0x21000000"
BR2_LINUX_KERNEL_INTREE_DTS_NAME="at91-wb40n"
BR2_PACKAGE_BUSYBOX_CONFIG="$(TOPDIR)/board/laird/wb40n_rdvk/configs/busybox-1.29.x.config"
BR2_PACKAGE_BUSYBOX_SHOW_OTHERS=y
BR2_PACKAGE_BZIP2=y
BR2_PACKAGE_LSOF=y
BR2_PACKAGE_CHECK=y
BR2_PACKAGE_MTD=y
BR2_PACKAGE_MTD_TESTS=y
BR2_PACKAGE_DEVMEM2=y
BR2_PACKAGE_I2C_TOOLS=y
BR2_PACKAGE_LINUXCONSOLETOOLS=y
BR2_PACKAGE_MEMTESTER=y
BR2_PACKAGE_SETSERIAL=y
BR2_PACKAGE_STATSERIAL=y
BR2_PACKAGE_UBOOT_TOOLS=y
BR2_PACKAGE_USBMOUNT=y
BR2_PACKAGE_USBUTILS=y
BR2_PACKAGE_OPENSSL=y
BR2_PACKAGE_LIBOPENSSL_BIN=y
BR2_PACKAGE_LIBTIRPC=y
BR2_PACKAGE_LIBEDIT=y
BR2_PACKAGE_BLUEZ5_UTILS=y
BR2_PACKAGE_BLUEZ5_UTILS_CLIENT=y
BR2_PACKAGE_BLUEZ5_UTILS_DEPRECATED=y
BR2_PACKAGE_BRCM_PATCHRAM_PLUS=y
BR2_PACKAGE_DHCP=y
BR2_PACKAGE_DHCP_CLIENT=y
BR2_PACKAGE_DNSMASQ=y
# BR2_PACKAGE_DNSMASQ_TFTP is not set
BR2_PACKAGE_DROPBEAR=y
BR2_PACKAGE_ETHTOOL=y
BR2_PACKAGE_IPERF=y
BR2_PACKAGE_IPTABLES=y
BR2_PACKAGE_IW=y
BR2_PACKAGE_NETWORK_MANAGER=y
BR2_PACKAGE_RSYNC=y
BR2_PACKAGE_TCPDUMP=y
BR2_PACKAGE_WGET=y
BR2_PACKAGE_WIRELESS_REGDB=y
BR2_PACKAGE_WPA_SUPPLICANT=y
BR2_PACKAGE_WPA_SUPPLICANT_AP_SUPPORT=y
BR2_PACKAGE_WPA_SUPPLICANT_AUTOSCAN=y
BR2_PACKAGE_WPA_SUPPLICANT_EAP=y
BR2_PACKAGE_WPA_SUPPLICANT_DEBUG_SYSLOG=y
BR2_PACKAGE_WPA_SUPPLICANT_CLI=y
BR2_PACKAGE_WPA_SUPPLICANT_PASSPHRASE=y
BR2_PACKAGE_WPA_SUPPLICANT_DBUS=y
BR2_PACKAGE_WPA_SUPPLICANT_DBUS_INTROSPECTION=y
BR2_PACKAGE_KMOD_TOOLS=y
BR2_PACKAGE_UTIL_LINUX_BINARIES=y
BR2_PACKAGE_UTIL_LINUX_HWCLOCK=y
BR2_TARGET_ROOTFS_TAR_BZIP2=y
BR2_TARGET_ROOTFS_UBI=y
BR2_TARGET_ROOTFS_UBIFS_MAXLEBCNT=955
BR2_TARGET_ROOTFS_UBIFS_LZO=y
BR2_TARGET_AT91BOOTSTRAP3=y
BR2_TARGET_AT91BOOTSTRAP3_DEFCONFIG="wb40n_uboot"
BR2_TARGET_UBOOT=y
BR2_TARGET_UBOOT_BUILD_SYSTEM_LEGACY=y
BR2_TARGET_UBOOT_BOARDNAME="wb40n"
BR2_PACKAGE_LRD_WIRELESS_REGDB=y
BR2_PACKAGE_SDCSUPP=y
BR2_PACKAGE_LAIRD_FIRMWARE=y
BR2_PACKAGE_LAIRD_FIRMWARE_AR6004=y
BR2_PACKAGE_LAIRD_FIRMWARE_BCM4343=y
BR2_PACKAGE_LAIRD_FIRMWARE_BCM4339=y
BR2_PACKAGE_LAIRD_FIRMWARE_LRDMWL_ST60_SDIO_UART=y
BR2_PACKAGE_LAIRD_FIRMWARE_LRDMWL_ST60_SDIO_SDIO=y
BR2_PACKAGE_LAIRD_FIRMWARE_LRDMWL_ST60_USB_UART=y
BR2_PACKAGE_LAIRD_FIRMWARE_LRDMWL_ST60_USB_USB=y
BR2_PACKAGE_LAIRD_FIRMWARE_LRDMWL_SU60_SDIO_UART=y
BR2_PACKAGE_LAIRD_FIRMWARE_LRDMWL_SU60_SDIO_SDIO=y
BR2_PACKAGE_LAIRD_FIRMWARE_LRDMWL_SU60_USB_UART=y
BR2_PACKAGE_LAIRD_FIRMWARE_LRDMWL_SU60_USB_USB=y
BR2_PACKAGE_ADAPTIVE_WW=y
```

## configs/wb45n_defconfig
```kconfig
BR2_arm=y
BR2_WGET="wget --passive-ftp -nd"
BR2_DL_DIR="$(TOPDIR)/../archive"
BR2_JLEVEL=16
BR2_PACKAGE_OVERRIDE_FILE="$(TOPDIR)/board/laird/wb45n/wb45n_devel-local.mk"
BR2_TOOLCHAIN_EXTERNAL=y
BR2_TOOLCHAIN_EXTERNAL_CUSTOM=y
BR2_TOOLCHAIN_EXTERNAL_PATH=""
BR2_TOOLCHAIN_EXTERNAL_CUSTOM_PREFIX="arm-laird-linux-gnueabi"
BR2_TOOLCHAIN_EXTERNAL_HEADERS_3_15=y
BR2_TOOLCHAIN_EXTERNAL_CUSTOM_GLIBC=y
# BR2_TOOLCHAIN_EXTERNAL_INET_RPC is not set
BR2_TOOLCHAIN_EXTERNAL_CXX=y
BR2_ENABLE_LOCALE_PURGE=y
BR2_ENABLE_LOCALE_WHITELIST="en_US"
BR2_TARGET_GENERIC_HOSTNAME="summit"
BR2_TARGET_GENERIC_ISSUE="Summit Data Communications"
BR2_ROOTFS_DEVICE_CREATION_DYNAMIC_EUDEV=y
BR2_ROOTFS_DEVICE_TABLE="board/laird/device_table.txt"
BR2_ROOTFS_POST_BUILD_SCRIPT="board/laird/wb45n/post_build.sh"
BR2_ROOTFS_POST_IMAGE_SCRIPT="board/laird/wb45n/post_image.sh"
BR2_LINUX_KERNEL=y
BR2_LINUX_KERNEL_DEFCONFIG="wb45n"
BR2_LINUX_KERNEL_APPENDED_UIMAGE=y
BR2_LINUX_KERNEL_UIMAGE_LOADADDR="0x22000000"
BR2_LINUX_KERNEL_INTREE_DTS_NAME="wb45n"
BR2_PACKAGE_BUSYBOX_CONFIG="$(TOPDIR)/board/laird/wb45n/configs/busybox-1.23.x.config"
BR2_PACKAGE_BUSYBOX_SHOW_OTHERS=y
BR2_PACKAGE_BZIP2=y
BR2_PACKAGE_GDB=y
BR2_PACKAGE_LSOF=y
BR2_PACKAGE_NETPERF=y
BR2_PACKAGE_STRACE=y
BR2_PACKAGE_WHETSTONE=y
BR2_PACKAGE_MTD=y
BR2_PACKAGE_DEVMEM2=y
BR2_PACKAGE_I2C_TOOLS=y
BR2_PACKAGE_INPUT_EVENT_DAEMON=y
BR2_PACKAGE_INPUT_TOOLS=y
# BR2_PACKAGE_INPUT_TOOLS_JSCAL is not set
# BR2_PACKAGE_INPUT_TOOLS_JSTEST is not set
BR2_PACKAGE_MEMTESTER=y
BR2_PACKAGE_SETSERIAL=y
BR2_PACKAGE_SREDIRD=y
BR2_PACKAGE_STATSERIAL=y
BR2_PACKAGE_USBMOUNT=y
BR2_PACKAGE_PHP=y
BR2_PACKAGE_PHP_EXT_ZIP=y
BR2_PACKAGE_PHP_EXT_JSON=y
BR2_PACKAGE_OPENSSL_BIN=y
BR2_PACKAGE_LIBDAEMON=y
BR2_PACKAGE_LIBEDIT=y
BR2_PACKAGE_BLUEZ5_UTILS=y
BR2_PACKAGE_BLUEZ5_UTILS_CLIENT=y
BR2_PACKAGE_BLUEZ5_UTILS_GATTTOOL=y
BR2_PACKAGE_BRIDGE_UTILS=y
BR2_PACKAGE_CONNTRACK_TOOLS=y
BR2_PACKAGE_CRDA=y
BR2_PACKAGE_DHCP=y
BR2_PACKAGE_DHCP_CLIENT=y
BR2_PACKAGE_EBTABLES=y
BR2_PACKAGE_ETHTOOL=y
BR2_PACKAGE_HOSTAPD=y
BR2_PACKAGE_IPERF=y
BR2_PACKAGE_IPROUTE2=y
BR2_PACKAGE_IPSEC_TOOLS=y
# BR2_PACKAGE_IPSEC_TOOLS_STATS is not set
BR2_PACKAGE_IPTABLES=y
BR2_PACKAGE_IW=y
BR2_PACKAGE_LIGHTTPD=y
BR2_PACKAGE_LIGHTTPD_OPENSSL=y
BR2_PACKAGE_LRZSZ=y
BR2_PACKAGE_MII_DIAG=y
BR2_PACKAGE_NCFTP=y
# BR2_PACKAGE_NCFTP_GET is not set
# BR2_PACKAGE_NCFTP_PUT is not set
# BR2_PACKAGE_NCFTP_LS is not set
# BR2_PACKAGE_NCFTP_BATCH is not set
BR2_PACKAGE_NDISC6=y
BR2_PACKAGE_NDISC6_NAME2ADDR=y
BR2_PACKAGE_NDISC6_NDISC6=y
BR2_PACKAGE_NDISC6_RDISC6=y
BR2_PACKAGE_NDISC6_RDNSSD=y
BR2_PACKAGE_NDISC6_RLTRACEROUTE6=y
BR2_PACKAGE_NDISC6_TCPTRACEROUTE6=y
BR2_PACKAGE_NDISC6_TCPSPRAY=y
BR2_PACKAGE_NETSTAT_NAT=y
BR2_PACKAGE_NTP=y
# BR2_PACKAGE_NTP_NTPD is not set
BR2_PACKAGE_NTP_NTPDATE=y
BR2_PACKAGE_OPENSSH=y
BR2_PACKAGE_OPENVPN=y
BR2_PACKAGE_PPPD=y
BR2_PACKAGE_PROFTPD=y
BR2_PACKAGE_RSYNC=y
BR2_PACKAGE_SER2NET=y
BR2_PACKAGE_SOCAT=y
BR2_PACKAGE_TCPDUMP=y
BR2_PACKAGE_VPNC=y
BR2_PACKAGE_WGET=y
BR2_PACKAGE_KMOD_TOOLS=y
BR2_PACKAGE_UTIL_LINUX_BINARIES=y
BR2_TARGET_ROOTFS_TAR_BZIP2=y
BR2_TARGET_ROOTFS_UBIFS=y
BR2_TARGET_ROOTFS_UBIFS_LEBSIZE=0x1f000
BR2_TARGET_ROOTFS_UBIFS_MAXLEBCNT=955
BR2_TARGET_ROOTFS_UBI=y
BR2_TARGET_ROOTFS_UBI_SUBSIZE=0
BR2_TARGET_AT91BOOTSTRAP3=y
BR2_TARGET_AT91BOOTSTRAP3_DEFCONFIG="at91sam9x5eknf_uboot"
BR2_TARGET_UBOOT=y
BR2_TARGET_UBOOT_BOARDNAME="wb45n"
BR2_TARGET_UBOOT_ENV_TOOLS=y
BR2_LRD_PLATFORM_WB45N=y
BR2_PACKAGE_MSD_BINARIES=y
BR2_MSD_BINARIES_COMPANY_PROJECT="laird"
BR2_MSD_BINARIES_VERSION="4.0.0.6"
# BR2_MSD_BINARIES_LLAGENT is not set
BR2_MSD_BINARIES_LAIRD_FIRMWARE_AR6003=y
BR2_PACKAGE_OPENSSL_FIPS=y
BR2_PACKAGE_PHP_SDK=y
BR2_PACKAGE_DCAS=y
```
