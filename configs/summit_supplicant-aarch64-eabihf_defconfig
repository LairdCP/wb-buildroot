## configs/wb60_defconfig
```kconfig
BR2_arm=y
BR2_cortex_a5=y
BR2_ARM_ENABLE_VFP=y
BR2_WGET="wget --passive-ftp -nd"
BR2_DL_DIR="$(HOME)/.br2_dl_dir"
BR2_CCACHE=y
BR2_CCACHE_DIR="$(BR2_DL_DIR)/.buildroot-ccache"
BR2_OPTIMIZE_3=y
BR2_PACKAGE_OVERRIDE_FILE="$(TOPDIR)/board/laird/som60/som60-local.mk"
BR2_TOOLCHAIN_EXTERNAL=y
BR2_TOOLCHAIN_EXTERNAL_LAIRD_ARM=y
BR2_TARGET_GENERIC_HOSTNAME="summit"
BR2_TARGET_GENERIC_ISSUE="Laird Connectivity"
BR2_INIT_SYSTEMD=y
BR2_ROOTFS_DEVICE_TABLE="board/laird/device_table.txt"
BR2_TARGET_GENERIC_ROOT_PASSWD="summit"
# BR2_TARGET_GENERIC_GETTY is not set
# BR2_TARGET_GENERIC_REMOUNT_ROOTFS_RW is not set
BR2_ENABLE_LOCALE_WHITELIST="en_US"
BR2_ROOTFS_POST_BUILD_SCRIPT="board/laird/som60/post_build.sh"
BR2_ROOTFS_POST_IMAGE_SCRIPT="board/laird/som60/post_image.sh"
BR2_ROOTFS_POST_SCRIPT_ARGS="som60 board/laird/configs-common/keys"
BR2_LINUX_KERNEL=y
BR2_LINUX_KERNEL_DEFCONFIG="wb60"
BR2_LINUX_KERNEL_IMAGE_TARGET_CUSTOM=y
BR2_LINUX_KERNEL_IMAGE_TARGET_NAME="Image"
BR2_LINUX_KERNEL_DTS_SUPPORT=y
BR2_LINUX_KERNEL_INTREE_DTS_NAME="at91-dvk_wb60"
BR2_PACKAGE_BUSYBOX_CONFIG="$(TOPDIR)/board/laird/configs-common/busybox.config"
BR2_PACKAGE_MTD=y
BR2_PACKAGE_DBUS_PYTHON=y
BR2_PACKAGE_DEVMEM2=y
BR2_PACKAGE_I2C_TOOLS=y
BR2_PACKAGE_LINUXCONSOLETOOLS=y
BR2_PACKAGE_MEMTESTER=y
BR2_PACKAGE_OFONO=y
BR2_PACKAGE_SETSERIAL=y
BR2_PACKAGE_UBOOT_TOOLS=y
BR2_PACKAGE_PYTHON3_GOBJECT=y
BR2_PACKAGE_LZO=y
BR2_PACKAGE_CA_CERTIFICATES=y
BR2_PACKAGE_CRYPTODEV=y
BR2_PACKAGE_LIBOPENSSL_BIN=y
BR2_PACKAGE_LIBCONFIG=y
BR2_PACKAGE_JSON_C=y
BR2_PACKAGE_LIBCURL=y
BR2_PACKAGE_LIBTIRPC=y
BR2_PACKAGE_GOBJECT_INTROSPECTION=y
BR2_PACKAGE_LIBDAEMON=y
BR2_PACKAGE_LIBEDIT=y
BR2_PACKAGE_BLUEZ5_UTILS=y
BR2_PACKAGE_BLUEZ5_UTILS_OBEX=y
BR2_PACKAGE_BLUEZ5_UTILS_CLIENT=y
BR2_PACKAGE_BLUEZ5_UTILS_EXPERIMENTAL=y
BR2_PACKAGE_CHRONY=y
BR2_PACKAGE_CONNTRACK_TOOLS=y
BR2_PACKAGE_DNSMASQ=y
# BR2_PACKAGE_DNSMASQ_TFTP is not set
BR2_PACKAGE_DNSMASQ_DNSSEC=y
BR2_PACKAGE_DROPBEAR=y
BR2_PACKAGE_ETHTOOL=y
BR2_PACKAGE_FIREWALLD=y
# BR2_PACKAGE_IFUPDOWN_SCRIPTS is not set
BR2_PACKAGE_IPERF=y
BR2_PACKAGE_IPERF3=y
BR2_PACKAGE_IPROUTE2=y
BR2_PACKAGE_IPSEC_TOOLS=y
# BR2_PACKAGE_IPSEC_TOOLS_STATS is not set
BR2_PACKAGE_IW=y
BR2_PACKAGE_MII_DIAG=y
BR2_PACKAGE_NETCAT=y
BR2_PACKAGE_NETSTAT_NAT=y
BR2_PACKAGE_RSYNC=y
BR2_PACKAGE_TCPDUMP=y
BR2_PACKAGE_LOCKFILE_PROGS=y
BR2_PACKAGE_SWUPDATE=y
BR2_PACKAGE_SWUPDATE_CONFIG="board/laird/configs-common/swupdate.config"
# BR2_PACKAGE_SWUPDATE_INSTALL_WEBSITE is not set
BR2_PACKAGE_SYSTEMD_HIBERNATE=y
# BR2_PACKAGE_SYSTEMD_HWDB is not set
BR2_PACKAGE_SYSTEMD_LOGIND=y
# BR2_PACKAGE_SYSTEMD_MYHOSTNAME is not set
# BR2_PACKAGE_SYSTEMD_NETWORKD is not set
# BR2_PACKAGE_SYSTEMD_RESOLVED is not set
# BR2_PACKAGE_SYSTEMD_TIMESYNCD is not set
# BR2_PACKAGE_SYSTEMD_VCONSOLE is not set
BR2_PACKAGE_UTIL_LINUX_HWCLOCK=y
BR2_TARGET_ROOTFS_SQUASHFS=y
BR2_TARGET_ROOTFS_SQUASHFS4_LZO=y
# BR2_TARGET_ROOTFS_TAR is not set
BR2_TARGET_UBOOT=y
BR2_TARGET_UBOOT_BUILD_SYSTEM_KCONFIG=y
BR2_TARGET_UBOOT_CUSTOM_VERSION=y
BR2_TARGET_UBOOT_CUSTOM_VERSION_VALUE="2018.01"
BR2_TARGET_UBOOT_BOARD_DEFCONFIG="wb60"
BR2_TARGET_UBOOT_NEEDS_DTC=y
# BR2_TARGET_UBOOT_FORMAT_BIN is not set
BR2_TARGET_UBOOT_FORMAT_CUSTOM=y
BR2_TARGET_UBOOT_FORMAT_CUSTOM_NAME="u-boot.dtb u-boot-nodtb.bin"
BR2_TARGET_UBOOT_SPL=y
BR2_TARGET_UBOOT_SPL_NAME="spl/u-boot-spl-nodtb.bin spl/u-boot-spl.dtb"
BR2_PACKAGE_HOST_CRYPTSETUP=y
BR2_PACKAGE_HOST_MTD=y
BR2_PACKAGE_HOST_UBOOT_TOOLS=y
BR2_PACKAGE_HOST_UBOOT_TOOLS_FIT_SUPPORT=y
BR2_PACKAGE_HOST_UBOOT_TOOLS_FIT_SIGNATURE_SUPPORT=y
BR2_LRD_SOM60_RADIO=y
BR2_PACKAGE_MC_MINT=y
BR2_PACKAGE_LRD_NETWORK_MANAGER_MODEM_MANAGER=y
BR2_PACKAGE_LRD_NETWORK_MANAGER_PPPD=y
BR2_PACKAGE_LRD_AUTOMOUNT=y
# BR2_PACKAGE_LRD_AUTOMOUNT_USB is not set
BR2_PACKAGE_LRD_USBGADGET=y
BR2_PACKAGE_LRD_ENCRYPTED_STORAGE_TOOLKIT=y
```

## package/brcm-patchram-plus/Config.in
```kconfig
config BR2_PACKAGE_BRCM_PATCHRAM_PLUS
	depends on BR2_PACKAGE_BLUEZ5_UTILS || BR2_PACKAGE_BLUEZ_UTILS
	bool "brcm-patchram-plus"
	help
	  Broadcom utility to flash Bluetooth firmwares, extended with
	  per-device Low Power Mode configuration.
```

## package/crda/Config.in
```kconfig
config BR2_PACKAGE_CRDA
	bool "crda"
	depends on BR2_PACKAGE_LIBGPG_ERROR_ARCH_SUPPORTS # libgcrypt
	depends on BR2_TOOLCHAIN_HAS_THREADS # libnl
	depends on !BR2_STATIC_LIBS
	select BR2_PACKAGE_LIBGCRYPT
	select BR2_PACKAGE_LIBNL
	# regdb is a runtime dependency
	select BR2_PACKAGE_WIRELESS_REGDB
	help
	  Central Regulatory Domain Agent.

	  This package provides a Central Regulatory Domain Agent (CRDA)
	  to be used by the Linux kernel cf80211 wireless subsystem to
	  query and apply the regulatory domain settings wireless
	  devices may operate within for a given location.

	  http://linuxwireless.org/en/developers/Regulatory/CRDA

if BR2_PACKAGE_CRDA

config BR2_PACKAGE_CRDA_NO_SIGN_CHECK
	bool "disable crda signature checking"
	help
		Disable CRDA from doing a signature check on the regulatory
		database.

endif

comment "crda needs a toolchain w/ threads, dynamic library"
	depends on !BR2_TOOLCHAIN_HAS_THREADS || BR2_STATIC_LIBS
```

## package/desktop-file-utils/Config.in
```kconfig
config BR2_PACKAGE_DESKTOP_FILE_UTILS
	bool "desktop-file-utils"
	depends on BR2_PACKAGE_LIBGLIB2
	help
	  desktop-file-utils contains a few command line utilities for working
	  with desktop entries.
	  https://freedesktop.org/wiki/Software/desktop-file-utils/
```

## package/firewalld/Config.in
```kconfig
config BR2_PACKAGE_FIREWALLD
	bool "firewalld"
	depends on BR2_USE_MMU # ebtables, gobject-introspection
	depends on BR2_USE_WCHAR # dbus-python, gettext
	depends on BR2_TOOLCHAIN_HEADERS_AT_LEAST_3_12 # nftables
	depends on BR2_PACKAGE_HOST_QEMU_ARCH_SUPPORTS # gobject-introspection
	depends on BR2_TOOLCHAIN_GCC_AT_LEAST_4_9 # gobject-introspection
	depends on BR2_TOOLCHAIN_HAS_THREADS # dbus-python
	depends on BR2_TOOLCHAIN_USES_GLIBC # gobject-introspection
	select BR2_PACKAGE_DBUS # dbus-python
	select BR2_PACKAGE_PYTHON3
	select BR2_PACKAGE_DBUS_PYTHON
	select BR2_PACKAGE_GETTEXT
	select BR2_PACKAGE_GOBJECT_INTROSPECTION
	select BR2_PACKAGE_IPTABLES
	select BR2_PACKAGE_JANSSON # Runtime
	select BR2_PACKAGE_NFTABLES
	select BR2_PACKAGE_PYTHON_DECORATOR
	select BR2_PACKAGE_PYTHON_GOBJECT
	select BR2_PACKAGE_PYTHON_SIX
	select BR2_PACKAGE_PYTHON_SLIP_DBUS
	help
	  Firewalld provides a dynamically managed firewall with
	  support for network or firewall zones to define the trust
	  level of network connections or interfaces. It has support
	  for IPv4, IPv6 firewall settings and for ethernet bridges and
	  a separation of runtime and permanent configuration options.
	  It also provides an interface for services or applications to
	  add ip*tables and ebtables rules directly.

	  https://github.com/firewalld/firewalld

if BR2_PACKAGE_FIREWALLD

config BR2_PACKAGE_FIREWALLD_DEFAULT_ZONE_VALUE
	string "Default zone name"
	default "trusted"

config BR2_PACKAGE_FIREWALLD_DEFAULT_BACKEND_VALUE
	string "Default backend name"
	default "iptables"

endif # BR2_PACKAGE_FIREWALLD

comment "firewalld needs a glibc toolchain w/ wchar, threads, gcc >= 4.9"
	depends on BR2_USE_MMU || !BR2_USE_WCHAR
	depends on BR2_PACKAGE_DBUS && BR2_PACKAGE_HOST_QEMU_ARCH_SUPPORTS
	depends on !BR2_TOOLCHAIN_USES_GLIBC || \
		!BR2_TOOLCHAIN_HAS_THREADS || !BR2_TOOLCHAIN_GCC_AT_LEAST_4_9
```

## package/flatcc/Config.in
```kconfig
config BR2_PACKAGE_FLATCC
	bool "flatcc"
	depends on BR2_ENDIAN = "LITTLE"
	help
	  flatcc is C language implementation of Google Flatbuffers. It
	  consists of both a library for the target as well as a
	  flatbuffer compiler tool for the host.

	  https://github.com/dvidelabs/flatcc
```

## package/fscryptctl/Config.in.host
```kconfig
config BR2_PACKAGE_HOST_FSCRYPTCTL
        bool "host fscryptctl"
        help
          host fscryptctl
```

## package/lrd-closed-source/Config.in
```kconfig
source "package/lrd-closed-source/sdcsdk/Config.in"
source "package/lrd-closed-source/sdccli/Config.in"
source "package/lrd-closed-source/sdcsupp/Config.in"
source "package/lrd-closed-source/dhd/Config.in"
source "package/lrd-closed-source/sdc2u/Config.in"
source "package/lrd-closed-source/ar6kl-tools/Config.in"
source "package/lrd-closed-source/weblcm-legacy/Config.in"
source "package/lrd-closed-source/llagent/Config.in"
source "package/lrd-closed-source/web_lcm_gatwick/Config.in"
source "package/lrd-closed-source/laird_firmware/Config.in"
source "package/lrd-closed-source/wl_fmac/Config.in"
source "package/lrd-closed-source/mfg60n/Config.in"
source "package/lrd-closed-source/nordic_ota/Config.in"
source "package/lrd-closed-source/adaptive_ww/Config.in"
source "package/lrd-closed-source/lru_ath6kl/Config.in"
source "package/lrd-closed-source/openssl-fips/Config.in"
source "package/lrd-closed-source/kcapi-module/Config.in"
source "package/lrd-closed-source/parser-cavs/Config.in"
source "package/lrd-closed-source/parser-acvp/Config.in"
source "package/lrd-closed-source/openssl-testing/Config.in"
source "package/lrd-closed-source/lru_cypress/Config.in"
source "package/lrd-closed-source/jitterrng-scripts/Config.in"
source "package/lrd-closed-source/waveagent/Config.in"
```

## package/lrd-closed-source/adaptive_ww/Config.in
```kconfig
config BR2_PACKAGE_ADAPTIVE_WW
	bool "Adaptive World Mode Service"
	select BR2_PACKAGE_LIBNL
	select BR2_PACKAGE_OPENSSL
	select BR2_PACKAGE_LIBCONFIG
	help
		Laird 60 Series Radio's Adaptive World Mode Feature

if BR2_PACKAGE_ADAPTIVE_WW

config BR2_PACKAGE_ADAPTIVE_WW_CFG_FILE
	string "Additional Configuration File"
	help
		Path and filename for runtinme configuration settings

choice
	prompt "AWM's interface preference"
	default BR2_PACKAGE_ADAPTIVE_WW_INTF_STA

config BR2_PACKAGE_ADAPTIVE_WW_INTF_STA
	bool "STA"
	help
		Use managed interfaces when available.
config BR2_PACKAGE_ADAPTIVE_WW_INTF_AP
	bool "AP"
	help
		Use AP interfaces when available.
config BR2_PACKAGE_ADAPTIVE_WW_INTF_NONE
	bool "NONE"
	help
		Use the first available interface.
endchoice

choice
	prompt "AWM's running mode"
	default BR2_PACKAGE_ADAPTIVE_WW_MODE_FULL

config BR2_PACKAGE_ADAPTIVE_WW_MODE_FULL
	bool "Full"
	help
		AWM mode which requires periodic geo-location validation.
config BR2_PACKAGE_ADAPTIVE_WW_MODE_LITE
	bool "Lite"
	help
		AWM mode which does not periodically validate geo-location.
endchoice

config BR2_PACKAGE_ADAPTIVE_WW_LPT
	bool "Adaptive World Mode Power Tool"
	depends on BR2_i386 || BR2_x86_64
	help
		Laird Tool used to create Regulatory Power Database

endif
```

## package/lrd-closed-source/ar6kl-tools-v311/Config.in
```kconfig
config BR2_PACKAGE_AR6KL_TOOLS_V311
	bool "Ar6kl Tools v3.1.1 (dbgParser)"
	help
	  Ar6kl Tools v3.1.1 for dbgParser. It dbgParser doesn't exist in later versions.
```

## package/lrd-closed-source/ar6kl-tools/Config.in
```kconfig
config BR2_PACKAGE_AR6KL_TOOLS
	bool "Ar6kl Tools"
	help
	  Ar6kl Tools

if BR2_PACKAGE_AR6KL_TOOLS

config BR2_PACKAGE_AR6KL_TOOLS_6004_SUPPORT
	bool "AR6004 support"
	help
	  Builds tools to support AR6004 instead of AR6003.

endif
```

## package/lrd-closed-source/bluetopia_samples/Config.in
```kconfig
config BR2_PACKAGE_BLUETOPIA_SAMPLES
	bool "bluetopia-samples"
	help
	  Bluetopia is the Bluetooth Protocol Stack by StoneStreet One.
          It provides a software architecture that encapsulates the
          upper functionality of the Bluetooth Protocol Stack. The
          package bluetopia-samples includes demo applications from SS1
	  for the Bluetopia stack.

comment "bluetopia-samples depends on libbluetopia"
```
